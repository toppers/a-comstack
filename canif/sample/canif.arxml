AUTOSAR XML (schema 4-0-3)
package /CanIf
  module config CanIf: ecuc-def-edition=4.2.0, implementation-config-variant=VARIANT-PRE-COMPILE
    CanIfPublicCfg:
      CanIfPublicCancelTransmitSupport = true
      CanIfPublicChangeBaudrateSupport = true
      CanIfPublicDevErrorDetect = true
      CanIfPublicHandleTypeEnum = UINT8
      CanIfPublicMultipleDrvSupport = false
      CanIfPublicNumberOfCanHwUnits = 1
      CanIfPublicPnSupport = false
      CanIfPublicReadRxPduDataApi = true
      CanIfPublicReadRxPduNotifyStatusApi = true
      CanIfPublicReadTxPduNotifyStatusApi = true
      CanIfPublicSetDynamicTxIdApi = false
      CanIfPublicTxBuffering = false
      CanIfPublicTxConfirmPollingSupport = true
      CanIfPublicVersionInfoApi = true
      CanIfPublicWakeupCheckValidSupport = true
    CanIfPrivateCfg: CanIfPrivateDlcCheck=true, CanIfSupportTTCAN=false
    CanIfDispatchCfg:
      CanIfDispatchUserCtrlBusOffName = CanSM_ControllerBusOff
      CanIfDispatchUserCtrlBusOffUL = CAN_SM
      CanIfDispatchUserCtrlModeIndicationName = CanSM_ControllerModeIndication
      CanIfDispatchUserCtrlModeIndicationUL = CAN_SM
      CanIfDispatchUserValidateWakeupEventName = EcuM_ValidateWakeupEvent
      CanIfDispatchUserValidateWakeupEventUL = ECUM
    CanIfInitCfg_0 (CanIfInitCfg): CanIfInitCfgSet=main_canif_config
      3 x CanIfBufferCfg, all with CanIfBufferSize=0:
        CanIfBufferCfg_{0..2}: CanIfBufferHthRef=CanIfHthCfg_{0..2}
      CanIfInitHohCfg_0 (CanIfInitHohCfg): CanIfInitRefCfgSet=CanConfigSet
        3 x CanIfHrhCfg, all with CanIfHrhSoftwareFilter=false:
          CanIfHrhCfg_0: CanIfHrhCanCtrlIdRef=CanIfCtrlCfg_0, CanIfHrhIdSymRef=CanHardwareObject_0
          CanIfHrhCfg_1: CanIfHrhCanCtrlIdRef=CanIfCtrlCfg_1, CanIfHrhIdSymRef=CanHardwareObject_2
          CanIfHrhCfg_2: CanIfHrhCanCtrlIdRef=CanIfCtrlCfg_0, CanIfHrhIdSymRef=CanHardwareObject_1
        3 x CanIfHthCfg:
          CanIfHthCfg_0: CanIfHthCanCtrlIdRef=CanIfCtrlCfg_0, CanIfHthIdSymRef=CanHardwareObject_5
          CanIfHthCfg_1: CanIfHthCanCtrlIdRef=CanIfCtrlCfg_1, CanIfHthIdSymRef=CanHardwareObject_3
          CanIfHthCfg_2: CanIfHthCanCtrlIdRef=CanIfCtrlCfg_1, CanIfHthIdSymRef=CanHardwareObject_4
      3 x CanIfRxPduCfg, all with CanIfRxPduCanIdType=STANDARD_CAN, CanIfRxPduUserRxIndicationName=PduR_CanIfRxIndication, CanIfRxPduUserRxIndicationUL=PDUR:
        CanIfRxPduCfg_0: CanIfRxPduCanId=1, CanIfRxPduDlc=7, CanIfRxPduId=1, CanIfRxPduReadData=false, CanIfRxPduReadNotifyStatus=false, CanIfRxPduHrhIdRef=CanIfHrhCfg_0, CanIfRxPduRef=Pdu_B
        CanIfRxPduCfg_1: CanIfRxPduCanId=4, CanIfRxPduDlc=4, CanIfRxPduId=4, CanIfRxPduReadData=true, CanIfRxPduReadNotifyStatus=true, CanIfRxPduHrhIdRef=CanIfHrhCfg_1, CanIfRxPduRef=Pdu_E
        CanIfRxPduCfg_2: CanIfRxPduCanId=5, CanIfRxPduDlc=3, CanIfRxPduId=5, CanIfRxPduReadData=true, CanIfRxPduReadNotifyStatus=false, CanIfRxPduHrhIdRef=CanIfHrhCfg_2, CanIfRxPduRef=Pdu_F
      3 x CanIfTxPduCfg, all with CanIfTxPduCanIdType=STANDARD_CAN, CanIfTxPduPnFilterPdu=false, CanIfTxPduType=STATIC, CanIfTxPduUserTxConfirmationName=PduR_CanIfTxConfirmation, CanIfTxPduUserTxConfirmationUL=PDUR:
        CanIfTxPduCfg_0: CanIfTxPduCanId=0, CanIfTxPduDlc=8, CanIfTxPduId=0, CanIfTxPduReadNotifyStatus=true, CanIfTxPduBufferRef=CanIfBufferCfg_0, CanIfTxPduRef=Pdu_A
        CanIfTxPduCfg_1: CanIfTxPduCanId=2, CanIfTxPduDlc=6, CanIfTxPduId=2, CanIfTxPduReadNotifyStatus=true, CanIfTxPduBufferRef=CanIfBufferCfg_1, CanIfTxPduRef=Pdu_C
        CanIfTxPduCfg_2: CanIfTxPduCanId=3, CanIfTxPduDlc=5, CanIfTxPduId=3, CanIfTxPduReadNotifyStatus=false, CanIfTxPduBufferRef=CanIfBufferCfg_2, CanIfTxPduRef=Pdu_D
    CanIfInitCfg_1 (CanIfInitCfg): CanIfInitCfgSet=sub_canif_config
      CanIfBufferCfg_3 (CanIfBufferCfg): CanIfBufferSize=0, CanIfBufferHthRef=CanIfHthCfg_3
      CanIfInitHohCfg_1 (CanIfInitHohCfg): CanIfInitRefCfgSet=CanConfigSet
        CanIfHthCfg_3 (CanIfHthCfg): CanIfHthCanCtrlIdRef=CanIfCtrlCfg_1, CanIfHthIdSymRef=CanHardwareObject_0
        CanIfHrhCfg_3 (CanIfHrhCfg): CanIfHrhSoftwareFilter=false, CanIfHrhCanCtrlIdRef=CanIfCtrlCfg_1, CanIfHrhIdSymRef=CanHardwareObject_1
      CanIfRxPduCfg_3 (CanIfRxPduCfg):
        CanIfRxPduCanId = 1
        CanIfRxPduCanIdType = STANDARD_CAN
        CanIfRxPduDlc = 8
        CanIfRxPduId = 1
        CanIfRxPduReadData = false
        CanIfRxPduReadNotifyStatus = true
        CanIfRxPduUserRxIndicationName = PduR_CanIfRxIndication
        CanIfRxPduUserRxIndicationUL = PDUR
        CanIfRxPduHrhIdRef = CanIfHrhCfg_3
        CanIfRxPduRef = Pdu_H
      CanIfTxPduCfg_3 (CanIfTxPduCfg):
        CanIfTxPduCanId = 0
        CanIfTxPduCanIdType = STANDARD_CAN
        CanIfTxPduDlc = 2
        CanIfTxPduId = 0
        CanIfTxPduPnFilterPdu = false
        CanIfTxPduReadNotifyStatus = false
        CanIfTxPduType = STATIC
        CanIfTxPduUserTxConfirmationName = PduR_CanIfTxConfirmation
        CanIfTxPduUserTxConfirmationUL = PDUR
        CanIfTxPduBufferRef = CanIfBufferCfg_3
        CanIfTxPduRef = Pdu_G
    CanIfCtrlDrvCfg_0 (CanIfCtrlDrvCfg): CanIfCtrlDrvTxCancellation=false, CanIfCtrlDrvInitHohConfigRef=CanIfInitHohCfg_0, CanIfCtrlDrvNameRef=CanGeneral
      CanIfCtrlCfg_0 (CanIfCtrlCfg): CanIfCtrlId=0, CanIfCtrlWakeupSupport=true, CanIfCtrlCanCtrlRef=CanController_0
      CanIfCtrlCfg_1 (CanIfCtrlCfg): CanIfCtrlId=1, CanIfCtrlWakeupSupport=false, CanIfCtrlCanCtrlRef=CanController_1
package /EcuC
  module config EcuC: ecuc-def-edition=4.2.0, implementation-config-variant=VARIANT-PRE-COMPILE
    EcucPduCollection
      8 x Pdu:
        Pdu_A: PduLength=3
        Pdu_B: PduLength=7
        Pdu_C: PduLength=4
        Pdu_D: PduLength=1
        Pdu_E: PduLength=4
        Pdu_F: PduLength=2
        Pdu_G: PduLength=2
        Pdu_H: PduLength=7
package /PduR
  module config PduR: ecuc-def-edition=4.2.0, implementation-config-variant=VARIANT-PRE-COMPILE
    PduRGeneral: PduRZeroCostOperation=true
    PduRRoutingTables: PduRConfigurationId=0
      PduRRoutingTable
        8 x PduRRoutingPath:
          PduRRoutingPath_0
            PduRDestPdu: PduRDestPduHandleId=0, PduRDestPduRef=Pdu_A
            PduRSrcPdu: PduRSourcePduHandleId=0, PduRSrcPduRef=Pdu_A
          PduRRoutingPath_1
            PduRDestPdu: PduRDestPduHandleId=1, PduRDestPduRef=Pdu_B
            PduRSrcPdu: PduRSourcePduHandleId=1, PduRSrcPduRef=Pdu_B
          PduRRoutingPath_2
            PduRDestPdu: PduRDestPduHandleId=2, PduRDestPduRef=Pdu_C
            PduRSrcPdu: PduRSourcePduHandleId=2, PduRSrcPduRef=Pdu_C
          PduRRoutingPath_3
            PduRDestPdu: PduRDestPduHandleId=3, PduRDestPduRef=Pdu_D
            PduRSrcPdu: PduRSourcePduHandleId=3, PduRSrcPduRef=Pdu_D
          PduRRoutingPath_4
            PduRDestPdu: PduRDestPduHandleId=4, PduRDestPduRef=Pdu_E
            PduRSrcPdu: PduRSourcePduHandleId=4, PduRSrcPduRef=Pdu_E
          PduRRoutingPath_5
            PduRDestPdu: PduRDestPduHandleId=5, PduRDestPduRef=Pdu_F
            PduRSrcPdu: PduRSourcePduHandleId=5, PduRSrcPduRef=Pdu_F
          PduRRoutingPath_6
            PduRDestPdu: PduRDestPduHandleId=6, PduRDestPduRef=Pdu_G
            PduRSrcPdu: PduRSourcePduHandleId=6, PduRSrcPduRef=Pdu_G
          PduRRoutingPath_7
            PduRDestPdu: PduRDestPduHandleId=7, PduRDestPduRef=Pdu_H
            PduRSrcPdu: PduRSourcePduHandleId=7, PduRSrcPduRef=Pdu_H
package /Can
  module config Can: ecuc-def-edition=4.2.0, implementation-config-variant=VARIANT-PRE-COMPILE
    CanConfigSet
      6 x CanHardwareObject:
        CanHardwareObject_{0..5}: CanIdValue={0..5}, CanObjectId={0..5}
      CanController_0 (CanController): CanControllerId=0, CanWakeupSourceRef=EcuMWakeupSource_0
      CanController_1 (CanController): CanControllerId=1, CanWakeupSourceRef=EcuMWakeupSource_1
    CanGeneral: CanIndex=0
package /EcuM
  module config EcuM: ecuc-def-edition=4.2.0, implementation-config-variant=VARIANT-PRE-COMPILE
    EcuMConfiguration
      EcuMCommonConfiguration
        EcuMWakeupSource_0 (EcuMWakeupSource): EcuMWakeupSourceId=0
        EcuMWakeupSource_1 (EcuMWakeupSource): EcuMWakeupSourceId=1
