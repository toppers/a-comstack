AUTOSAR XML (schema 4-0-3)
package /Can
  module config Can: ecuc-def-edition=4.2.0, implementation-config-variant=VARIANT-PRE-COMPILE
    CanConfigSet
      CanController_0 (CanController):
        CanBusoffProcessing = INTERRUPT
        CanControllerId = 0
        CanRxProcessing = INTERRUPT
        CanTxProcessing = INTERRUPT
        CanWakeupProcessing = INTERRUPT
        CanWakeupSupport = false
        CanControllerDefaultBaudrate = CanControllerBaudrateConfig_0
        CanWakeupSourceRef = EcuMWakeupSource_0
        CanControllerBaudrateConfig_0 (CanControllerBaudrateConfig): CanControllerBaudRate=500, CanControllerPropSeg=8, CanControllerSeg1=5, CanControllerSeg2=5, CanControllerSyncJumpWidth=1
        CanControllerBaudrateConfig_1 (CanControllerBaudrateConfig): CanControllerBaudRate=250, CanControllerPropSeg=4, CanControllerSeg1=5, CanControllerSeg2=5, CanControllerSyncJumpWidth=1
        CanFilterMask_0 (CanFilterMask): CanFilterMaskValue=4094
      CanController_1 (CanController):
        CanBusoffProcessing = INTERRUPT
        CanControllerId = 1
        CanRxProcessing = INTERRUPT
        CanTxProcessing = INTERRUPT
        CanWakeupProcessing = INTERRUPT
        CanWakeupSupport = false
        CanControllerDefaultBaudrate = CanControllerBaudrateConfig_2
        CanWakeupSourceRef = EcuMWakeupSource_0
        CanControllerBaudrateConfig_2 (CanControllerBaudrateConfig): CanControllerBaudRate=500, CanControllerPropSeg=8, CanControllerSeg1=5, CanControllerSeg2=5, CanControllerSyncJumpWidth=1
        CanControllerBaudrateConfig_3 (CanControllerBaudrateConfig): CanControllerBaudRate=250, CanControllerPropSeg=4, CanControllerSeg1=5, CanControllerSeg2=5, CanControllerSyncJumpWidth=1
        CanFilterMask_1 (CanFilterMask): CanFilterMaskValue=240
      10 x CanHardwareObject, all with CanHandleType=FULL, CanIdType=STANDARD:
        CanHardwareObject_0: CanIdValue=291, CanObjectId=0, CanObjectType=RECEIVE, CanControllerRef=CanController_0, CanFilterMaskRef=CanFilterMask_0
        CanHardwareObject_1: CanIdValue=3, CanObjectId=1, CanObjectType=RECEIVE, CanControllerRef=CanController_0
        CanHardwareObject_2: CanIdValue=4, CanObjectId=2, CanObjectType=RECEIVE, CanControllerRef=CanController_0
        CanHardwareObject_3: CanIdValue=1, CanObjectId=3, CanObjectType=TRANSMIT, CanControllerRef=CanController_0
        CanHardwareObject_4: CanIdValue=2, CanObjectId=4, CanObjectType=TRANSMIT, CanControllerRef=CanController_0
        CanHardwareObject_5: CanIdValue=16, CanObjectId=5, CanObjectType=RECEIVE, CanControllerRef=CanController_1, CanFilterMaskRef=CanFilterMask_1
        CanHardwareObject_6: CanIdValue=1, CanObjectId=6, CanObjectType=RECEIVE, CanControllerRef=CanController_1
        CanHardwareObject_7: CanIdValue=2, CanObjectId=7, CanObjectType=RECEIVE, CanControllerRef=CanController_1
        CanHardwareObject_8: CanIdValue=3, CanObjectId=8, CanObjectType=TRANSMIT, CanControllerRef=CanController_1
        CanHardwareObject_9: CanIdValue=4, CanObjectId=9, CanObjectType=TRANSMIT, CanControllerRef=CanController_1
    CanGeneral:
      CanChangeBaudrateApi = true
      CanDevErrorDetection = true
      CanIndex = 0
      CanLPduReceiveCalloutFunction = CanCalloutFunction
      CanMainFunctionModePeriod = 0.01
      CanMultiplexedTransmission = false
      CanVersionInfoApi = true
      CanTimeoutDuration = 0.1
      CanCounterRef = MAIN_HW_COUNTER
      CanMainFunctionRWPeriods: CanMainFunctionWritePeriod=0.01, CanMainFunctionReadPeriod=0.01
package /EcuM
  module config EcuM: ecuc-def-edition=4.2.0, implementation-config-variant=VARIANT-PRE-COMPILE
    EcuMConfiguration
      EcuMCommonConfiguration
        EcuMWakeupSource_0 (EcuMWakeupSource): EcuMWakeupSourceId=0
package /CanIf
  module config CanIf: ecuc-def-edition=4.2.0, implementation-config-variant=VARIANT-PRE-COMPILE
    CanIfCtrlDrvCfg_0 (CanIfCtrlDrvCfg)
      CanIfCtrlCfg_0 (CanIfCtrlCfg): CanIfCtrlId=0, CanIfCtrlCanCtrlRef=CanController_0
    CanIfCtrlDrvCfg_1 (CanIfCtrlDrvCfg)
      CanIfCtrlCfg_1 (CanIfCtrlCfg): CanIfCtrlId=1, CanIfCtrlCanCtrlRef=CanController_1
