AUTOSAR XML (schema 4-0-3)
package /Can
  module config Can: ecuc-def-edition=4.2.0, implementation-config-variant=VARIANT-PRE-COMPILE
    CanConfigSet
      CanController_0 (CanController):
        CanBusoffProcessing = INTERRUPT
        CanControllerId = 0
        CanRxProcessing = INTERRUPT
        CanTxProcessing = INTERRUPT
        CanWakeupProcessing = INTERRUPT
        CanWakeupSupport = false
        CanControllerDefaultBaudrate = CanControllerBaudrateConfig_0
        CanWakeupSourceRef = EcuMWakeupSource_0
        CanControllerBaudrateConfig_0 (CanControllerBaudrateConfig): CanControllerBaudRate=500, CanControllerPropSeg=8, CanControllerSeg1=5, CanControllerSeg2=5, CanControllerSyncJumpWidth=1
        CanControllerBaudrateConfig_1 (CanControllerBaudrateConfig): CanControllerBaudRate=250, CanControllerPropSeg=4, CanControllerSeg1=5, CanControllerSeg2=5, CanControllerSyncJumpWidth=1
        CanFilterMask_0 (CanFilterMask): CanFilterMaskValue=4094
      5 x CanHardwareObject, all with CanHandleType=FULL, CanIdType=STANDARD, CanControllerRef=CanController_0:
        CanHardwareObject_0: CanIdValue=291, CanObjectId=0, CanObjectType=RECEIVE, CanFilterMaskRef=CanFilterMask_0
        CanHardwareObject_1: CanIdValue=3, CanObjectId=1, CanObjectType=RECEIVE
        CanHardwareObject_2: CanIdValue=4, CanObjectId=2, CanObjectType=RECEIVE
        CanHardwareObject_3: CanIdValue=1, CanObjectId=3, CanObjectType=TRANSMIT
        CanHardwareObject_4: CanIdValue=2, CanObjectId=4, CanObjectType=TRANSMIT
    CanGeneral:
      CanIndex = 0
      CanChangeBaudrateApi = true
      CanDevErrorDetection = true
      CanLPduReceiveCalloutFunction = CanCalloutFunction
      CanMainFunctionModePeriod = 0.01
      CanMultiplexedTransmission = false
      CanVersionInfoApi = true
      CanTimeoutDuration = 0.1
      CanCounterRef = MAIN_HW_COUNTER
      CanMainFunctionRWPeriods: CanMainFunctionWritePeriod=0.01, CanMainFunctionReadPeriod=0.01
package /EcuM
  module config EcuM: ecuc-def-edition=4.2.0, implementation-config-variant=VARIANT-PRE-COMPILE
    EcuMConfiguration
      EcuMCommonConfiguration
        EcuMWakeupSource_0 (EcuMWakeupSource): EcuMWakeupSourceId=0
package /CanIf
  module config CanIf: ecuc-def-edition=4.2.0, implementation-config-variant=VARIANT-PRE-COMPILE
    CanIfCtrlDrvCfg_0 (CanIfCtrlDrvCfg)
      CanIfCtrlCfg_0 (CanIfCtrlCfg): CanIfCtrlId=0, CanIfCtrlCanCtrlRef=CanController_0
