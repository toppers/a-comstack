AUTOSAR XML (schema 4-0-3)
package /Os
  module config Os: ecuc-def-edition=4.2.0, implementation-config-variant=VARIANT-PRE-COMPILE
    MainApp (OsAppMode)
    OsOS: OsStackMonitoring=true, OsStatus=EXTENDED, OsUseGetServiceId=true, OsUseParameterAccess=true, OsScalabilityClass=SC1
      OsHooks: OsErrorHook=false, OsPostTaskHook=false, OsPreTaskHook=false, OsProtectionHook=true, OsShutdownHook=false, OsStartupHook=true
      OsHookStack: OsHookStackSize=1024
      OsOsStack: OsOsStackSize=8192
    MainTask (OsTask): OsTaskActivation=1, OsTaskPriority=0, OsTaskSchedule=FULL, OsTaskStackSize=4096
      OsTaskAutostart: OsTaskAppModeRef=MainApp
    SendTask (OsTask): OsTaskActivation=1, OsTaskPriority=5, OsTaskSchedule=FULL, OsTaskStackSize=4096
    ALARM1 (OsAlarm): OsAlarmCounterRef=MAIN_HW_COUNTER
      OsAlarmAction
        OsAlarmActivateTask: OsAlarmActivateTaskRef=SendTask
      OsAlarmAutostart: OsAlarmAutostartType=RELATIVE, OsAlarmAlarmTime=8000000, OsAlarmCycleTime=8000000, OsAlarmAppModeRef=MainApp
    OsInclude: OsIncludeFileName=Can_Target.h
    C2ISR_FOR_CAN_RX0 (OsIsr): OsIsrCategory=CATEGORY_2, OsIsrInterruptNumber=25, OsIsrInterruptPriority=3, OsIsrInterruptSource=ENABLE, OsIsrResourceRef=COMSTACK_RESOURCE
    C2ISR_FOR_CAN_TX0 (OsIsr): OsIsrCategory=CATEGORY_2, OsIsrInterruptNumber=26, OsIsrInterruptPriority=3, OsIsrInterruptSource=ENABLE, OsIsrResourceRef=COMSTACK_RESOURCE
    COMSTACK_RESOURCE (OsResource): OsResourceProperty=STANDARD
    CAN_REENTRANT (OsResource): OsResourceProperty=LINKED, OsResourceLinkedResourceRef=COMSTACK_RESOURCE
