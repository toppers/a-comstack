AUTOSAR XML (schema 4-0-3)
package /Com
  module config Com: ecuc-def-edition=4.2.0, implementation-config-variant=VARIANT-PRE-COMPILE
    ComGeneral:
      ComSupportedIPduGroups = 1
      ComVersionInfoApi = true
      ComConfigurationUseDet = true
      ComRetryFailedTransmitRequests = true
      ComEnableMDTForCyclicTransmission = true
    ComConfig_0 (ComConfig): ComConfigurationId=0
      ComTimeBase: ComTxTimeBase=0.2, ComRxTimeBase=0.1
      4 x ComIPduGroup:
        ComIPduGroup_{0..3}: ComIPduGroupHandleId={0..3}
      IPDU_A (ComIPdu):
        ComIPduDirection = SEND
        ComIPduSignalProcessing = IMMEDIATE
        ComIPduHandleId = 0
        ComIPduType = NORMAL
        ComIPduCancellationSupport = true
        ComIPduGroupRef = ComIPduGroup_0
        ComIPduGroupRef = ComIPduGroup_2
        ComIPduSignalRef = SIGNAL_A
        ComIPduSignalRef = SIGNAL_B
        ComPduIdRef = Pdu_a
        ComTxIPdu: ComMinimumDelayTime=1.0, ComTxIPduUnusedAreasDefault=1
          ComTxModeFalse
            ComTxMode: ComTxModeMode=DIRECT, ComTxModeNumberOfRepetitions=0, ComTxModeRepetitionPeriod=0.0
          ComTxModeTrue
            ComTxMode: ComTxModeMode=DIRECT, ComTxModeNumberOfRepetitions=0, ComTxModeRepetitionPeriod=0.0
      SIGNAL_A (ComSignal):
        ComBitPosition = 3
        ComBitSize = 1
        ComHandleId = 5
        ComSignalDataInvalidValue = true
        ComSignalEndianness = LITTLE_ENDIAN
        ComSignalInitValue = false
        ComSignalType = BOOLEAN
        ComTransferProperty = TRIGGERED
        ComFilter: ComFilterAlgorithm=ALWAYS
      SIGNAL_B (ComSignal):
        ComBitPosition = 5
        ComBitSize = 6
        ComHandleId = 0
        ComSignalDataInvalidValue = 31
        ComSignalEndianness = LITTLE_ENDIAN
        ComSignalInitValue = -15
        ComSignalType = SINT8
        ComTransferProperty = TRIGGERED
        ComFilter: ComFilterAlgorithm=MASKED_NEW_DIFFERS_X, ComFilterMask=27, ComFilterX=28
      IPDU_B (ComIPdu):
        ComIPduDirection = RECEIVE
        ComIPduSignalProcessing = IMMEDIATE
        ComIPduHandleId = 1
        ComIPduType = NORMAL
        ComIPduGroupRef = ComIPduGroup_0
        ComIPduGroupRef = ComIPduGroup_2
        ComIPduSignalRef = SIGNAL_C
        ComPduIdRef = Pdu_b
      SIGNAL_C (ComSignal):
        ComBitPosition = 0
        ComBitSize = 8
        ComFirstTimeout = 20.0
        ComHandleId = 1
        ComSignalDataInvalidValue = -15
        ComSignalEndianness = LITTLE_ENDIAN
        ComSignalInitValue = -15
        ComSignalType = SINT16
        ComFilter: ComFilterAlgorithm=ALWAYS
      IPDU_C (ComIPdu):
        ComIPduDirection = SEND
        ComIPduSignalProcessing = IMMEDIATE
        ComIPduHandleId = 2
        ComIPduType = NORMAL
        ComIPduCancellationSupport = false
        ComIPduGroupRef = ComIPduGroup_0
        ComIPduSignalRef = SIGNAL_D
        ComPduIdRef = Pdu_c
        ComTxIPdu: ComMinimumDelayTime=1.0, ComTxIPduUnusedAreasDefault=1
          ComTxModeTrue
            ComTxMode: ComTxModeMode=DIRECT, ComTxModeNumberOfRepetitions=0, ComTxModeRepetitionPeriod=0.0
      SIGNAL_D (ComSignal):
        ComBitPosition = 3
        ComBitSize = 28
        ComHandleId = 4
        ComSignalDataInvalidValue = 31
        ComSignalEndianness = LITTLE_ENDIAN
        ComSignalInitValue = -3
        ComSignalType = SINT32
        ComTransferProperty = TRIGGERED
        ComFilter: ComFilterAlgorithm=ALWAYS
      IPDU_D (ComIPdu):
        ComIPduDirection = SEND
        ComIPduSignalProcessing = IMMEDIATE
        ComIPduHandleId = 3
        ComIPduType = NORMAL
        ComIPduCancellationSupport = false
        ComIPduGroupRef = ComIPduGroup_0
        ComIPduSignalRef = SIGNAL_E
        ComPduIdRef = Pdu_d
        ComTxIPdu: ComMinimumDelayTime=1.0, ComTxIPduUnusedAreasDefault=1
          ComTxModeTrue
            ComTxMode: ComTxModeMode=DIRECT, ComTxModeNumberOfRepetitions=0, ComTxModeRepetitionPeriod=0.0
      SIGNAL_E (ComSignal):
        ComBitPosition = 3
        ComBitSize = 5
        ComHandleId = 2
        ComSignalDataInvalidValue = 31U
        ComSignalEndianness = LITTLE_ENDIAN
        ComSignalInitValue = 4U
        ComSignalType = UINT8
        ComTransferProperty = TRIGGERED
        ComFilter: ComFilterAlgorithm=ALWAYS
      IPDU_E (ComIPdu):
        ComIPduDirection = RECEIVE
        ComIPduSignalProcessing = IMMEDIATE
        ComIPduHandleId = 4
        ComIPduType = NORMAL
        ComIPduGroupRef = ComIPduGroup_0
        ComIPduGroupRef = ComIPduGroup_3
        ComIPduSignalRef = SIGNAL_F
        ComIPduSignalRef = SIGNAL_G
        ComIPduSignalRef = SIGNAL_H
        ComPduIdRef = Pdu_e
      3 x ComSignal:
        SIGNAL_F: ComBitPosition=0, ComBitSize=12, ComHandleId=3, ComSignalDataInvalidValue=31U, ComSignalEndianness=LITTLE_ENDIAN, ComSignalInitValue=15U, ComSignalType=UINT16
          ComFilter: ComFilterAlgorithm=MASKED_NEW_DIFFERS_X, ComFilterMask=27U, ComFilterX=28U
        SIGNAL_G: ComBitPosition=12, ComBitSize=12, ComHandleId=6, ComSignalDataInvalidValue=31U, ComSignalEndianness=LITTLE_ENDIAN, ComSignalInitValue=15U, ComSignalType=UINT32
          ComFilter: ComFilterAlgorithm=MASKED_NEW_DIFFERS_X, ComFilterMask=27U, ComFilterX=28U
        SIGNAL_H: ComBitPosition=24, ComHandleId=7, ComSignalDataInvalidValue=5U 6U 7U 8U 9U, ComSignalEndianness=opaque, ComSignalInitValue=0U 1U 2U 3U 4U, ComSignalType=UINT8_N, ComSignalLength=5
          ComFilter: ComFilterAlgorithm=ALWAYS
      IPDU_F (ComIPdu):
        ComIPduDirection = SEND
        ComIPduSignalProcessing = IMMEDIATE
        ComIPduHandleId = 5
        ComIPduType = NORMAL
        ComIPduCancellationSupport = false
        ComIPduGroupRef = ComIPduGroup_1
        ComIPduGroupRef = ComIPduGroup_3
        ComIPduSignalRef = SIGNAL_I
        ComPduIdRef = Pdu_f
        ComTxIPdu: ComMinimumDelayTime=1.0, ComTxIPduUnusedAreasDefault=1
          ComTxModeFalse
            ComTxMode: ComTxModeMode=DIRECT, ComTxModeNumberOfRepetitions=0, ComTxModeRepetitionPeriod=0.0
      SIGNAL_I (ComSignal):
        ComBitPosition = 3
        ComBitSize = 22
        ComHandleId = 8
        ComSignalDataInvalidValue = 31
        ComSignalEndianness = LITTLE_ENDIAN
        ComSignalInitValue = 4
        ComSignalType = SINT32
        ComTransferProperty = TRIGGERED
        ComFilter: ComFilterAlgorithm=NEVER
    ComConfig_1 (ComConfig): ComConfigurationId=1
      ComTimeBase: ComTxTimeBase=0.3, ComRxTimeBase=0.4
      ComIPduGroup_4 (ComIPduGroup): ComIPduGroupHandleId=0
      IPDU_G (ComIPdu):
        ComIPduDirection = SEND
        ComIPduSignalProcessing = IMMEDIATE
        ComIPduHandleId = 0
        ComIPduType = NORMAL
        ComIPduCancellationSupport = false
        ComIPduGroupRef = ComIPduGroup_4
        ComIPduSignalRef = SIGNAL_J
        ComPduIdRef = Pdu_g
        ComTxIPdu: ComMinimumDelayTime=1.0, ComTxIPduUnusedAreasDefault=1
          ComTxModeFalse
            ComTxMode: ComTxModeMode=DIRECT, ComTxModeNumberOfRepetitions=0, ComTxModeRepetitionPeriod=0.0
      SIGNAL_J (ComSignal):
        ComBitPosition = 0
        ComFirstTimeout = 20.0
        ComHandleId = 0
        ComSignalDataInvalidValue = 5U 6U 7U 8U 9U
        ComSignalEndianness = opaque
        ComSignalInitValue = 0U 1U 2U 3U 4U
        ComSignalType = UINT8_N
        ComSignalLength = 5
        ComTransferProperty = PENDING
        ComFilter: ComFilterAlgorithm=NEVER
package /EcuC
  module config EcuC: ecuc-def-edition=4.2.0, implementation-config-variant=VARIANT-PRE-COMPILE
    EcucPduCollection
      7 x Pdu:
        Pdu_a: PduLength=4
        Pdu_b: PduLength=8
        Pdu_c: PduLength=8
        Pdu_d: PduLength=4
        Pdu_e: PduLength=12
        Pdu_f: PduLength=4
        Pdu_g: PduLength=8
package /PduR
  module config PduR: ecuc-def-edition=4.2.0, implementation-config-variant=VARIANT-PRE-COMPILE
    PduRGeneral: PduRZeroCostOperation=true
    PduRRoutingTables: PduRConfigurationId=0
      PduRRoutingTable
        7 x PduRRoutingPath:
          PduRRoutingPath_0
            PduRSrcPdu: PduRSourcePduHandleId=0, PduRSrcPduRef=Pdu_a
          PduRRoutingPath_1
            PduRSrcPdu: PduRSourcePduHandleId=1, PduRSrcPduRef=Pdu_b
          PduRRoutingPath_2
            PduRSrcPdu: PduRSourcePduHandleId=2, PduRSrcPduRef=Pdu_c
          PduRRoutingPath_3
            PduRSrcPdu: PduRSourcePduHandleId=3, PduRSrcPduRef=Pdu_d
          PduRRoutingPath_4
            PduRSrcPdu: PduRSourcePduHandleId=4, PduRSrcPduRef=Pdu_e
          PduRRoutingPath_5
            PduRSrcPdu: PduRSourcePduHandleId=5, PduRSrcPduRef=Pdu_f
          PduRRoutingPath_6
            PduRSrcPdu: PduRSourcePduHandleId=6, PduRSrcPduRef=Pdu_g
