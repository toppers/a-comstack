AUTOSAR XML (schema 4-0-3)
package /Com
  module config Com: ecuc-def-edition=4.2.0, implementation-config-variant=VARIANT-PRE-COMPILE
    ComGeneral:
      ComSupportedIPduGroups = 1
      ComVersionInfoApi = true
      ComConfigurationUseDet = true
      ComRetryFailedTransmitRequests = true
      ComEnableMDTForCyclicTransmission = true
    ComConfig_0 (ComConfig): ComConfigurationId=0
      ComTimeBase: ComTxTimeBase=0.2, ComRxTimeBase=0.1
      ComIPduGroup_0 (ComIPduGroup): ComIPduGroupHandleId=0
      IPDU_A (ComIPdu):
        ComIPduDirection = SEND
        ComIPduSignalProcessing = IMMEDIATE
        ComIPduHandleId = 0
        ComIPduType = NORMAL
        ComIPduCancellationSupport = true
        ComIPduGroupRef = ComIPduGroup_0
        ComIPduSignalRef = SIGNAL_A
        ComIPduSignalGroupRef = SIGNAL_G_A
        ComPduIdRef = Pdu_a
        ComTxIPdu: ComTxIPduUnusedAreasDefault=1
          ComTxModeFalse
            ComTxMode: ComTxModeMode=DIRECT, ComTxModeNumberOfRepetitions=2, ComTxModeRepetitionPeriod=3.0
          ComTxModeTrue
            ComTxMode: ComTxModeMode=PERIODIC, ComTxModeTimeOffset=3.0, ComTxModeTimePeriod=5.0
      SIGNAL_A (ComSignal):
        ComBitPosition = 0
        ComBitSize = 8
        ComHandleId = 0
        ComFirstTimeout = 2.0
        ComTimeout = 4.0
        ComTimeoutNotification = Rte_COMCbkTxTOut_sn0
        ComSignalDataInvalidValue = 11
        ComSignalEndianness = LITTLE_ENDIAN
        ComSignalInitValue = 1
        ComSignalType = UINT8
        ComTransferProperty = TRIGGERED_ON_CHANGE
        ComFilter: ComFilterAlgorithm=MASKED_NEW_DIFFERS_MASKED_OLD, ComFilterMask=1
      SIGNAL_G_A (ComSignalGroup): ComHandleId=0, ComTransferProperty=TRIGGERED_ON_CHANGE, ComFirstTimeout=2.0, ComTimeout=4.0, ComTimeoutNotification=Rte_COMCbkTxTOut_sn1
        SIGNAL_B (ComGroupSignal):
          ComBitPosition = 8
          ComBitSize = 8
          ComHandleId = 1
          ComSignalDataInvalidValue = 22
          ComSignalEndianness = LITTLE_ENDIAN
          ComSignalInitValue = 2
          ComSignalType = UINT8
          ComTransferProperty = TRIGGERED_ON_CHANGE
          ComFilter: ComFilterAlgorithm=MASKED_NEW_EQUALS_X, ComFilterMask=28, ComFilterX=28
        SIGNAL_C (ComGroupSignal):
          ComBitPosition = 16
          ComBitSize = 8
          ComHandleId = 2
          ComSignalDataInvalidValue = 33
          ComSignalEndianness = LITTLE_ENDIAN
          ComSignalInitValue = 3
          ComSignalType = UINT8
          ComTransferProperty = TRIGGERED_ON_CHANGE
          ComFilter: ComFilterAlgorithm=MASKED_NEW_EQUALS_X, ComFilterMask=28, ComFilterX=28
      IPDU_B (ComIPdu):
        ComIPduDirection = RECEIVE
        ComIPduSignalProcessing = IMMEDIATE
        ComIPduHandleId = 1
        ComIPduType = NORMAL
        ComIPduGroupRef = ComIPduGroup_0
        ComIPduSignalRef = SIGNAL_D
        ComIPduSignalGroupRef = SIGNAL_G_B
        ComPduIdRef = Pdu_b
      SIGNAL_D (ComSignal):
        ComBitPosition = 0
        ComBitSize = 8
        ComHandleId = 3
        ComFirstTimeout = 2.0
        ComTimeout = 4.0
        ComTimeoutNotification = Rte_COMCbkRxTOut_sn0
        ComSignalDataInvalidValue = 44
        ComSignalEndianness = LITTLE_ENDIAN
        ComSignalInitValue = 4
        ComSignalType = UINT8
        ComTransferProperty = TRIGGERED
      SIGNAL_G_B (ComSignalGroup): ComHandleId=1, ComTransferProperty=TRIGGERED_ON_CHANGE, ComFirstTimeout=2.0, ComTimeout=4.0, ComTimeoutNotification=Rte_COMCbkRxTOut_sn1
        SIGNAL_E (ComGroupSignal):
          ComBitPosition = 8
          ComBitSize = 8
          ComHandleId = 4
          ComSignalDataInvalidValue = 55
          ComSignalEndianness = LITTLE_ENDIAN
          ComSignalInitValue = 5
          ComSignalType = UINT8
          ComTransferProperty = TRIGGERED_ON_CHANGE
        SIGNAL_F (ComGroupSignal):
          ComBitPosition = 16
          ComBitSize = 8
          ComHandleId = 5
          ComSignalDataInvalidValue = 66
          ComSignalEndianness = LITTLE_ENDIAN
          ComSignalInitValue = 6
          ComSignalType = UINT8
          ComTransferProperty = TRIGGERED_ON_CHANGE
package /EcuC
  module config EcuC: ecuc-def-edition=4.2.0, implementation-config-variant=VARIANT-PRE-COMPILE
    EcucPduCollection
      Pdu_a (Pdu): PduLength=4
      Pdu_b (Pdu): PduLength=4
package /PduR
  module config PduR: ecuc-def-edition=4.2.0, implementation-config-variant=VARIANT-PRE-COMPILE
    PduRGeneral: PduRZeroCostOperation=true
    PduRRoutingTables: PduRConfigurationId=0
      PduRRoutingTable
        PduRRoutingPath_0 (PduRRoutingPath)
          PduRSrcPdu: PduRSourcePduHandleId=0, PduRSrcPduRef=Pdu_a
        PduRRoutingPath_1 (PduRRoutingPath)
          PduRSrcPdu: PduRSourcePduHandleId=1, PduRSrcPduRef=Pdu_b
