AUTOSAR XML (schema 4-0-3)
package /Com
  module config Com: ecuc-def-edition=4.2.0, implementation-config-variant=VARIANT-PRE-COMPILE
    ComConfig_0 (ComConfig): ComConfigurationId=0
      12 x ComIPdu, all with ComIPduDirection=SEND, ComIPduGroupRef=ComIPduGroup_0:
        ComIPdu_0: ComIPduCallout=IPDU_Callout_0, ComIPduHandleId=0, ComIPduSignalProcessing=IMMEDIATE, ComIPduType=NORMAL, ComIPduCancellationSupport=false, ComIPduSignalRef=ComSignal_0, ComIPduSignalRef=ComSignal_1, ComIPduSignalRef=ComSignal_2, ComIPduSignalRef=ComSignal_3, ComIPduSignalRef=ComSignal_4, ComIPduSignalRef=ComSignal_5, ComIPduSignalRef=ComSignal_6, ComIPduSignalRef=ComSignal_7, ComIPduSignalRef=ComSignal_8, ComPduIdRef=Pdu_0
          ComTxIPdu: ComMinimumDelayTime=2.0, ComTxIPduUnusedAreasDefault=15
            ComTxModeFalse
              ComTxMode: ComTxModeMode=PERIODIC, ComTxModeTimeOffset=3.0, ComTxModeTimePeriod=5.0
            ComTxModeTrue
              ComTxMode: ComTxModeMode=NONE
        ComIPdu_1: ComIPduCallout=IPDU_Callout_1, ComIPduHandleId=1, ComIPduSignalProcessing=DEFERRED, ComIPduType=NORMAL, ComIPduSignalRef=ComSignal_9, ComIPduSignalRef=ComSignal_10, ComIPduSignalRef=ComSignal_11, ComIPduSignalRef=ComSignal_12, ComIPduSignalRef=ComSignal_13, ComIPduSignalRef=ComSignal_14, ComIPduSignalRef=ComSignal_15, ComIPduSignalRef=ComSignal_16, ComIPduSignalRef=ComSignal_17, ComPduIdRef=Pdu_1
          ComTxIPdu: ComTxIPduUnusedAreasDefault=10
            ComTxModeFalse
              ComTxMode: ComTxModeMode=PERIODIC, ComTxModeTimeOffset=3.0, ComTxModeTimePeriod=5.0
            ComTxModeTrue
              ComTxMode: ComTxModeMode=DIRECT
        ComIPdu_2: ComIPduCallout=IPDU_Callout_2, ComIPduHandleId=2, ComIPduSignalProcessing=DEFERRED, ComIPduType=TP, ComIPduCancellationSupport=false, ComIPduSignalRef=ComSignal_18, ComIPduSignalRef=ComSignal_19, ComIPduSignalRef=ComSignal_20, ComIPduSignalRef=ComSignal_21, ComIPduSignalRef=ComSignal_22, ComIPduSignalRef=ComSignal_23, ComIPduSignalRef=ComSignal_24, ComIPduSignalRef=ComSignal_25, ComIPduSignalRef=ComSignal_26, ComPduIdRef=Pdu_2
          ComTxIPdu: ComMinimumDelayTime=2.0, ComTxIPduUnusedAreasDefault=5
            ComTxModeFalse
              ComTxMode: ComTxModeMode=PERIODIC, ComTxModeTimeOffset=3.0, ComTxModeTimePeriod=5.0
            ComTxModeTrue
              ComTxMode: ComTxModeMode=DIRECT
        ComIPdu_3: ComIPduCallout=IPDU_Callout_3, ComIPduHandleId=3, ComIPduSignalProcessing=IMMEDIATE, ComIPduType=TP, ComIPduCancellationSupport=true, ComIPduSignalRef=ComSignal_27, ComIPduSignalRef=ComSignal_28, ComIPduSignalRef=ComSignal_29, ComIPduSignalRef=ComSignal_30, ComIPduSignalRef=ComSignal_31, ComIPduSignalRef=ComSignal_32, ComIPduSignalRef=ComSignal_33, ComIPduSignalRef=ComSignal_34, ComIPduSignalRef=ComSignal_35, ComPduIdRef=Pdu_3
          ComTxIPdu: ComMinimumDelayTime=2.0, ComTxIPduUnusedAreasDefault=3
            ComTxModeFalse
              ComTxMode: ComTxModeMode=DIRECT
            ComTxModeTrue
              ComTxMode: ComTxModeMode=PERIODIC, ComTxModeTimeOffset=3.0, ComTxModeTimePeriod=5.0
        ComIPdu_4: ComIPduCallout=IPDU_Callout_4, ComIPduHandleId=4, ComIPduSignalProcessing=IMMEDIATE, ComIPduType=NORMAL, ComIPduCancellationSupport=false, ComIPduSignalRef=ComSignal_36, ComIPduSignalRef=ComSignal_37, ComIPduSignalRef=ComSignal_38, ComIPduSignalRef=ComSignal_39, ComIPduSignalRef=ComSignal_40, ComIPduSignalRef=ComSignal_41, ComIPduSignalRef=ComSignal_42, ComIPduSignalRef=ComSignal_43, ComIPduSignalRef=ComSignal_44, ComPduIdRef=Pdu_4
          ComTxIPdu: ComMinimumDelayTime=2.0, ComTxIPduUnusedAreasDefault=6
            ComTxModeFalse
              ComTxMode: ComTxModeMode=PERIODIC, ComTxModeTimeOffset=3.0, ComTxModeTimePeriod=5.0
            ComTxModeTrue
              ComTxMode: ComTxModeMode=DIRECT, ComTxModeNumberOfRepetitions=2, ComTxModeRepetitionPeriod=3.0
        ComIPdu_5: ComIPduCallout=IPDU_Callout_5, ComIPduHandleId=5, ComIPduSignalProcessing=IMMEDIATE, ComIPduType=NORMAL, ComIPduCancellationSupport=false, ComIPduSignalRef=ComSignal_45, ComIPduSignalRef=ComSignal_46, ComIPduSignalRef=ComSignal_47, ComIPduSignalRef=ComSignal_48, ComIPduSignalRef=ComSignal_49, ComIPduSignalRef=ComSignal_50, ComIPduSignalRef=ComSignal_51, ComIPduSignalRef=ComSignal_52, ComIPduSignalRef=ComSignal_53, ComIPduSignalRef=ComSignal_54, ComPduIdRef=Pdu_5
          ComTxIPdu: ComMinimumDelayTime=2.0, ComTxIPduUnusedAreasDefault=1
            ComTxModeFalse
              ComTxMode: ComTxModeMode=PERIODIC, ComTxModeTimeOffset=3.0, ComTxModeTimePeriod=5.0
            ComTxModeTrue
              ComTxMode: ComTxModeMode=DIRECT
        ComIPdu_6: ComIPduCallout=IPDU_Callout_6, ComIPduHandleId=6, ComIPduSignalProcessing=IMMEDIATE, ComIPduType=NORMAL, ComIPduCancellationSupport=false, ComIPduSignalRef=ComSignal_55, ComIPduSignalRef=ComSignal_56, ComIPduSignalRef=ComSignal_57, ComIPduSignalRef=ComSignal_58, ComIPduSignalRef=ComSignal_59, ComIPduSignalRef=ComSignal_60, ComIPduSignalRef=ComSignal_61, ComIPduSignalRef=ComSignal_62, ComIPduSignalRef=ComSignal_63, ComIPduSignalRef=ComSignal_64, ComPduIdRef=Pdu_6
          ComTxIPdu: ComMinimumDelayTime=2.0, ComTxIPduUnusedAreasDefault=3
            ComTxModeFalse
              ComTxMode: ComTxModeMode=PERIODIC, ComTxModeTimeOffset=3.0, ComTxModeTimePeriod=5.0
            ComTxModeTrue
              ComTxMode: ComTxModeMode=DIRECT, ComTxModeNumberOfRepetitions=0, ComTxModeRepetitionPeriod=3.0
        ComIPdu_7: ComIPduCallout=IPDU_Callout_7, ComIPduHandleId=7, ComIPduSignalProcessing=IMMEDIATE, ComIPduType=NORMAL, ComIPduCancellationSupport=true, ComIPduSignalRef=ComSignal_65, ComIPduSignalRef=ComSignal_66, ComIPduSignalRef=ComSignal_67, ComIPduSignalRef=ComSignal_68, ComIPduSignalRef=ComSignal_69, ComIPduSignalRef=ComSignal_70, ComIPduSignalRef=ComSignal_71, ComIPduSignalRef=ComSignal_72, ComIPduSignalRef=ComSignal_73, ComIPduSignalRef=ComSignal_74, ComPduIdRef=Pdu_7
          ComTxIPdu: ComMinimumDelayTime=2.0, ComTxIPduUnusedAreasDefault=12
            ComTxModeFalse
              ComTxMode: ComTxModeMode=DIRECT, ComTxModeNumberOfRepetitions=2, ComTxModeRepetitionPeriod=3.0
            ComTxModeTrue
              ComTxMode: ComTxModeMode=PERIODIC, ComTxModeTimeOffset=3.0, ComTxModeTimePeriod=5.0
        ComIPdu_8: ComIPduCallout=IPDU_Callout_8, ComIPduHandleId=8, ComIPduSignalProcessing=IMMEDIATE, ComIPduType=NORMAL, ComIPduCancellationSupport=true, ComIPduSignalRef=ComSignal_75, ComIPduSignalRef=ComSignal_76, ComIPduSignalRef=ComSignal_77, ComIPduSignalRef=ComSignal_78, ComIPduSignalRef=ComSignal_79, ComIPduSignalRef=ComSignal_80, ComPduIdRef=Pdu_8
          ComTxIPdu: ComMinimumDelayTime=1.0, ComTxIPduUnusedAreasDefault=5
            ComTxModeFalse
              ComTxMode: ComTxModeMode=DIRECT
            ComTxModeTrue
              ComTxMode: ComTxModeMode=MIXED, ComTxModeNumberOfRepetitions=3, ComTxModeRepetitionPeriod=3.0, ComTxModeTimeOffset=2.0, ComTxModeTimePeriod=4.0
        ComIPdu_9: ComIPduCallout=IPDU_Callout_9, ComIPduHandleId=9, ComIPduSignalProcessing=IMMEDIATE, ComIPduType=TP, ComIPduCancellationSupport=true, ComIPduSignalRef=ComSignal_81, ComPduIdRef=Pdu_9
          ComTxIPdu: ComMinimumDelayTime=2.0, ComTxIPduUnusedAreasDefault=3
            ComTxModeFalse
              ComTxMode: ComTxModeMode=PERIODIC, ComTxModeTimeOffset=3.0, ComTxModeTimePeriod=5.0
            ComTxModeTrue
              ComTxMode: ComTxModeMode=DIRECT
        ComIPdu_10: ComIPduCallout=IPDU_Callout_10, ComIPduHandleId=10, ComIPduSignalProcessing=IMMEDIATE, ComIPduType=NORMAL, ComIPduCancellationSupport=true, ComIPduSignalRef=ComSignal_82, ComPduIdRef=Pdu_10
          ComTxIPdu: ComMinimumDelayTime=1.0, ComTxIPduUnusedAreasDefault=3
            ComTxModeFalse
              ComTxMode: ComTxModeMode=MIXED, ComTxModeNumberOfRepetitions=3, ComTxModeRepetitionPeriod=3.0, ComTxModeTimeOffset=2.0, ComTxModeTimePeriod=4.0
            ComTxModeTrue
              ComTxMode: ComTxModeMode=PERIODIC, ComTxModeTimeOffset=3.0, ComTxModeTimePeriod=5.0
        ComIPdu_11: ComIPduHandleId=11, ComIPduSignalProcessing=IMMEDIATE, ComIPduType=NORMAL, ComIPduCancellationSupport=false, ComIPduSignalRef=ComSignal_83, ComPduIdRef=Pdu_11
          ComTxIPdu: ComMinimumDelayTime=2.0, ComTxIPduUnusedAreasDefault=0
            ComTxModeFalse
              ComTxMode: ComTxModeMode=DIRECT
            ComTxModeTrue
              ComTxMode: ComTxModeMode=DIRECT
      ComIPduGroup_0 (ComIPduGroup): ComIPduGroupHandleId=0
      84 x ComSignal:
        ComSignal_0: ComBitPosition=3, ComBitSize=5, ComErrorNotification=Rte_COMCbkTErr_sn0, ComFirstTimeout=20.0, ComHandleId=0, ComNotification=Rte_COMCbkTAck_sn0, ComSignalDataInvalidValue=-1, ComSignalEndianness=LITTLE_ENDIAN, ComSignalInitValue=0, ComSignalType=SINT8, ComTimeout=25.0, ComTimeoutNotification=Rte_COMCbkTxTOut_sn0, ComTransferProperty=TRIGGERED, ComUpdateBitPosition=2
          ComFilter: ComFilterAlgorithm=MASKED_NEW_DIFFERS_X, ComFilterMask=27, ComFilterX=28
        ComSignal_1: ComBitPosition=8, ComBitSize=7, ComErrorNotification=Rte_COMCbkTErr_sn1, ComFirstTimeout=20.0, ComHandleId=1, ComNotification=Rte_COMCbkTAck_sn1, ComSignalDataInvalidValue=42, ComSignalEndianness=BIG_ENDIAN, ComSignalInitValue=-43, ComSignalType=SINT16, ComTimeout=25.0, ComTimeoutNotification=Rte_COMCbkTxTOut_sn1, ComTransferProperty=TRIGGERED, ComUpdateBitPosition=15
          ComFilter: ComFilterAlgorithm=MASKED_NEW_DIFFERS_X, ComFilterMask=28, ComFilterX=48
        ComSignal_2: ComBitPosition=18, ComBitSize=1, ComErrorNotification=Rte_COMCbkTErr_sn2, ComFirstTimeout=20.0, ComHandleId=2, ComNotification=Rte_COMCbkTAck_sn2, ComSignalDataInvalidValue=0, ComSignalEndianness=LITTLE_ENDIAN, ComSignalInitValue=1, ComSignalType=BOOLEAN, ComTimeout=25.0, ComTimeoutNotification=Rte_COMCbkTxTOut_sn2, ComTransferProperty=TRIGGERED, ComUpdateBitPosition=16
          ComFilter: ComFilterAlgorithm=MASKED_NEW_DIFFERS_X, ComFilterMask=1, ComFilterX=0
        ComSignal_3: ComBitPosition=50, ComBitSize=28, ComErrorNotification=Rte_COMCbkTErr_sn3, ComFirstTimeout=20.0, ComHandleId=3, ComNotification=Rte_COMCbkTAck_sn3, ComSignalDataInvalidValue=265080016, ComSignalEndianness=BIG_ENDIAN, ComSignalInitValue=178956976, ComSignalType=UINT32, ComTimeout=25.0, ComTimeoutNotification=Rte_COMCbkTxTOut_sn3, ComTransferProperty=TRIGGERED, ComUpdateBitPosition=31
        ComSignal_4: ComBitPosition=56, ComBitSize=8, ComErrorNotification=Rte_COMCbkTErr_sn4, ComFirstTimeout=20.0, ComHandleId=4, ComNotification=Rte_COMCbkTAck_sn4, ComSignalDataInvalidValue=238, ComSignalEndianness=LITTLE_ENDIAN, ComSignalInitValue=255, ComSignalType=UINT32, ComTimeout=25.0, ComTimeoutNotification=Rte_COMCbkTxTOut_sn4, ComTransferProperty=TRIGGERED, ComUpdateBitPosition=48
          ComFilter: ComFilterAlgorithm=MASKED_NEW_DIFFERS_X, ComFilterMask=60, ComFilterX=1
        ComSignal_5: ComBitPosition=66, ComBitSize=5, ComErrorNotification=Rte_COMCbkTErr_sn5, ComFirstTimeout=20.0, ComHandleId=5, ComNotification=Rte_COMCbkTAck_sn5, ComSignalDataInvalidValue=0, ComSignalEndianness=BIG_ENDIAN, ComSignalInitValue=1, ComSignalType=UINT8, ComTimeout=25.0, ComTimeoutNotification=Rte_COMCbkTxTOut_sn5, ComTransferProperty=TRIGGERED, ComUpdateBitPosition=71
          ComFilter: ComFilterAlgorithm=MASKED_NEW_DIFFERS_X, ComFilterMask=15, ComFilterX=4
        ComSignal_6: ComBitPosition=72, ComBitSize=8, ComErrorNotification=Rte_COMCbkTErr_sn6, ComFirstTimeout=20.0, ComHandleId=6, ComNotification=Rte_COMCbkTAck_sn6, ComSignalDataInvalidValue=255, ComSignalEndianness=LITTLE_ENDIAN, ComSignalInitValue=0, ComSignalType=UINT16, ComTimeout=25.0, ComTimeoutNotification=Rte_COMCbkTxTOut_sn6, ComTransferProperty=TRIGGERED, ComUpdateBitPosition=83
          ComFilter: ComFilterAlgorithm=MASKED_NEW_DIFFERS_X, ComFilterMask=195, ComFilterX=128
        ComSignal_7: ComBitPosition=85, ComBitSize=11, ComErrorNotification=Rte_COMCbkTErr_sn7, ComFirstTimeout=20.0, ComHandleId=7, ComNotification=Rte_COMCbkTAck_sn7, ComSignalDataInvalidValue=1450, ComSignalEndianness=LITTLE_ENDIAN, ComSignalInitValue=1911, ComSignalType=UINT16, ComTimeout=25.0, ComTimeoutNotification=Rte_COMCbkTxTOut_sn7, ComTransferProperty=TRIGGERED, ComUpdateBitPosition=96
        ComSignal_8: ComBitPosition=98, ComBitSize=20, ComErrorNotification=Rte_COMCbkTErr_sn8, ComFirstTimeout=20.0, ComHandleId=8, ComNotification=Rte_COMCbkTAck_sn8, ComSignalDataInvalidValue=209715, ComSignalEndianness=LITTLE_ENDIAN, ComSignalInitValue=-209716, ComSignalType=SINT32, ComTimeout=25.0, ComTimeoutNotification=Rte_COMCbkTxTOut_sn8, ComTransferProperty=TRIGGERED, ComUpdateBitPosition=119
          ComFilter: ComFilterAlgorithm=MASKED_NEW_DIFFERS_X, ComFilterMask=209715, ComFilterX=209715
        ComSignal_9: ComBitPosition=3, ComBitSize=5, ComErrorNotification=Rte_COMCbkTErr_sn9, ComFirstTimeout=20.0, ComHandleId=9, ComNotification=Rte_COMCbkTAck_sn9, ComSignalDataInvalidValue=-1, ComSignalEndianness=LITTLE_ENDIAN, ComSignalInitValue=0, ComSignalType=SINT8, ComTimeout=25.0, ComTimeoutNotification=Rte_COMCbkTxTOut_sn9, ComTransferProperty=TRIGGERED, ComUpdateBitPosition=2
          ComFilter: ComFilterAlgorithm=MASKED_NEW_EQUALS_X, ComFilterMask=27, ComFilterX=16
        ComSignal_10: ComBitPosition=8, ComBitSize=7, ComErrorNotification=Rte_COMCbkTErr_sn10, ComFirstTimeout=20.0, ComHandleId=10, ComNotification=Rte_COMCbkTAck_sn10, ComSignalDataInvalidValue=42, ComSignalEndianness=BIG_ENDIAN, ComSignalInitValue=-43, ComSignalType=SINT16, ComTimeout=25.0, ComTimeoutNotification=Rte_COMCbkTxTOut_sn10, ComTransferProperty=TRIGGERED, ComUpdateBitPosition=15
          ComFilter: ComFilterAlgorithm=MASKED_NEW_EQUALS_X, ComFilterMask=28, ComFilterX=12
        ComSignal_11: ComBitPosition=18, ComBitSize=1, ComErrorNotification=Rte_COMCbkTErr_sn11, ComFirstTimeout=20.0, ComHandleId=11, ComNotification=Rte_COMCbkTAck_sn11, ComSignalDataInvalidValue=0, ComSignalEndianness=LITTLE_ENDIAN, ComSignalInitValue=1, ComSignalType=BOOLEAN, ComTimeout=25.0, ComTimeoutNotification=Rte_COMCbkTxTOut_sn11, ComTransferProperty=TRIGGERED, ComUpdateBitPosition=16
          ComFilter: ComFilterAlgorithm=MASKED_NEW_EQUALS_X, ComFilterMask=1, ComFilterX=1
        ComSignal_12: ComBitPosition=50, ComBitSize=28, ComErrorNotification=Rte_COMCbkTErr_sn12, ComFirstTimeout=20.0, ComHandleId=12, ComNotification=Rte_COMCbkTAck_sn12, ComSignalDataInvalidValue=265080016, ComSignalEndianness=BIG_ENDIAN, ComSignalInitValue=178956976, ComSignalType=UINT32, ComTimeout=25.0, ComTimeoutNotification=Rte_COMCbkTxTOut_sn12, ComTransferProperty=TRIGGERED, ComUpdateBitPosition=31
        ComSignal_13: ComBitPosition=56, ComBitSize=8, ComErrorNotification=Rte_COMCbkTErr_sn13, ComFirstTimeout=20.0, ComHandleId=13, ComNotification=Rte_COMCbkTAck_sn13, ComSignalDataInvalidValue=238, ComSignalEndianness=LITTLE_ENDIAN, ComSignalInitValue=255, ComSignalType=UINT32, ComTimeout=25.0, ComTimeoutNotification=Rte_COMCbkTxTOut_sn13, ComTransferProperty=TRIGGERED, ComUpdateBitPosition=48
          ComFilter: ComFilterAlgorithm=MASKED_NEW_EQUALS_X, ComFilterMask=60, ComFilterX=128
        ComSignal_14: ComBitPosition=66, ComBitSize=5, ComErrorNotification=Rte_COMCbkTErr_sn14, ComFirstTimeout=20.0, ComHandleId=14, ComNotification=Rte_COMCbkTAck_sn14, ComSignalDataInvalidValue=0, ComSignalEndianness=BIG_ENDIAN, ComSignalInitValue=1, ComSignalType=UINT8, ComTimeout=25.0, ComTimeoutNotification=Rte_COMCbkTxTOut_sn14, ComTransferProperty=TRIGGERED, ComUpdateBitPosition=71
          ComFilter: ComFilterAlgorithm=MASKED_NEW_EQUALS_X, ComFilterMask=15, ComFilterX=3
        ComSignal_15: ComBitPosition=72, ComBitSize=8, ComErrorNotification=Rte_COMCbkTErr_sn15, ComFirstTimeout=20.0, ComHandleId=15, ComNotification=Rte_COMCbkTAck_sn15, ComSignalDataInvalidValue=255, ComSignalEndianness=LITTLE_ENDIAN, ComSignalInitValue=0, ComSignalType=UINT16, ComTimeout=25.0, ComTimeoutNotification=Rte_COMCbkTxTOut_sn15, ComTransferProperty=TRIGGERED, ComUpdateBitPosition=83
          ComFilter: ComFilterAlgorithm=MASKED_NEW_EQUALS_X, ComFilterMask=195, ComFilterX=129
        ComSignal_16: ComBitPosition=85, ComBitSize=11, ComErrorNotification=Rte_COMCbkTErr_sn16, ComFirstTimeout=20.0, ComHandleId=16, ComNotification=Rte_COMCbkTAck_sn16, ComSignalDataInvalidValue=1450, ComSignalEndianness=LITTLE_ENDIAN, ComSignalInitValue=1911, ComSignalType=UINT16, ComTimeout=20.0, ComTimeoutNotification=Rte_COMCbkTxTOut_sn16, ComTransferProperty=TRIGGERED, ComUpdateBitPosition=96
        ComSignal_17: ComBitPosition=98, ComBitSize=20, ComErrorNotification=Rte_COMCbkTErr_sn17, ComFirstTimeout=20.0, ComHandleId=17, ComNotification=Rte_COMCbkTAck_sn17, ComSignalDataInvalidValue=209715, ComSignalEndianness=LITTLE_ENDIAN, ComSignalInitValue=-209716, ComSignalType=SINT32, ComTimeout=25.0, ComTimeoutNotification=Rte_COMCbkTxTOut_sn17, ComTransferProperty=TRIGGERED, ComUpdateBitPosition=119
          ComFilter: ComFilterAlgorithm=MASKED_NEW_EQUALS_X, ComFilterMask=209715, ComFilterX=139810
        ComSignal_18: ComBitPosition=3, ComBitSize=13, ComDataInvalidAction=NOTIFY, ComErrorNotification=Rte_COMCbkTErr_sn18, ComFirstTimeout=20.0, ComHandleId=18, ComNotification=Rte_COMCbkTAck_sn18, ComSignalDataInvalidValue=8191, ComSignalEndianness=LITTLE_ENDIAN, ComSignalInitValue=255, ComSignalType=UINT16, ComTimeout=25.0, ComTimeoutNotification=Rte_COMCbkTxTOut_sn18, ComTransferProperty=TRIGGERED, ComUpdateBitPosition=1
          ComFilter: ComFilterAlgorithm=NEW_IS_WITHIN, ComFilterMax=8191, ComFilterMin=4096
        ComSignal_19: ComBitPosition=17, ComBitSize=11, ComDataInvalidAction=REPLACE, ComErrorNotification=Rte_COMCbkTErr_sn19, ComFirstTimeout=15.0, ComHandleId=19, ComNotification=Rte_COMCbkTAck_sn19, ComSignalDataInvalidValue=273, ComSignalEndianness=LITTLE_ENDIAN, ComSignalInitValue=0, ComSignalType=SINT16, ComTimeout=20.0, ComTimeoutNotification=Rte_COMCbkTxTOut_sn19, ComTransferProperty=TRIGGERED, ComUpdateBitPosition=29
          ComFilter: ComFilterAlgorithm=NEW_IS_WITHIN, ComFilterMax=511, ComFilterMin=256
        ComSignal_20: ComBitPosition=34, ComBitSize=17, ComDataInvalidAction=NOTIFY, ComErrorNotification=Rte_COMCbkTErr_sn20, ComFirstTimeout=20.0, ComHandleId=20, ComNotification=Rte_COMCbkTAck_sn20, ComSignalDataInvalidValue=78643, ComSignalEndianness=LITTLE_ENDIAN, ComSignalInitValue=511, ComSignalType=UINT32, ComTimeout=25.0, ComTimeoutNotification=Rte_COMCbkTxTOut_sn20, ComTransferProperty=PENDING, ComUpdateBitPosition=51
          ComFilter: ComFilterAlgorithm=NEW_IS_WITHIN, ComFilterMax=30583, ComFilterMin=4369
        ComSignal_21: ComBitPosition=53, ComBitSize=11, ComDataInvalidAction=REPLACE, ComErrorNotification=Rte_COMCbkTErr_sn21, ComFirstTimeout=15.0, ComHandleId=21, ComNotification=Rte_COMCbkTAck_sn21, ComSignalDataInvalidValue=-888, ComSignalEndianness=LITTLE_ENDIAN, ComSignalInitValue=273, ComSignalType=SINT32, ComTimeout=20.0, ComTimeoutNotification=Rte_COMCbkTxTOut_sn21, ComTransferProperty=PENDING, ComUpdateBitPosition=65
          ComFilter: ComFilterAlgorithm=NEW_IS_WITHIN, ComFilterMax=768, ComFilterMin=512
        ComSignal_22: ComBitPosition=68, ComBitSize=4, ComDataInvalidAction=NOTIFY, ComErrorNotification=Rte_COMCbkTErr_sn22, ComFirstTimeout=15.0, ComHandleId=22, ComNotification=Rte_COMCbkTAck_sn22, ComSignalDataInvalidValue=0, ComSignalEndianness=BIG_ENDIAN, ComSignalInitValue=10, ComSignalType=UINT8, ComTimeout=20.0, ComTimeoutNotification=Rte_COMCbkTxTOut_sn22, ComTransferProperty=TRIGGERED, ComUpdateBitPosition=67
          ComFilter: ComFilterAlgorithm=NEW_IS_WITHIN, ComFilterMax=10, ComFilterMin=5
        ComSignal_23: ComBitPosition=72, ComBitSize=8, ComDataInvalidAction=NOTIFY, ComErrorNotification=Rte_COMCbkTErr_sn23, ComFirstTimeout=20.0, ComHandleId=23, ComNotification=Rte_COMCbkTAck_sn23, ComSignalDataInvalidValue=-128, ComSignalEndianness=BIG_ENDIAN, ComSignalInitValue=-52, ComSignalType=SINT8, ComTimeout=25.0, ComTimeoutNotification=Rte_COMCbkTxTOut_sn23, ComTransferProperty=PENDING, ComUpdateBitPosition=87
          ComFilter: ComFilterAlgorithm=NEW_IS_WITHIN, ComFilterMax=175, ComFilterMin=170
        ComSignal_24: ComBitPosition=92, ComBitSize=9, ComDataInvalidAction=REPLACE, ComErrorNotification=Rte_COMCbkTErr_sn24, ComFirstTimeout=15.0, ComHandleId=24, ComNotification=Rte_COMCbkTAck_sn24, ComSignalDataInvalidValue=256, ComSignalEndianness=BIG_ENDIAN, ComSignalInitValue=5, ComSignalType=UINT16, ComTimeout=20.0, ComTimeoutNotification=Rte_COMCbkTxTOut_sn24, ComTransferProperty=TRIGGERED, ComUpdateBitPosition=85
        ComSignal_25: ComBitPosition=104, ComBitSize=18, ComDataInvalidAction=NOTIFY, ComErrorNotification=Rte_COMCbkTErr_sn25, ComFirstTimeout=20.0, ComHandleId=25, ComNotification=Rte_COMCbkTAck_sn25, ComSignalDataInvalidValue=61166, ComSignalEndianness=BIG_ENDIAN, ComSignalInitValue=375, ComSignalType=UINT32, ComTimeout=25.0, ComTimeoutNotification=Rte_COMCbkTxTOut_sn25, ComTransferProperty=TRIGGERED, ComUpdateBitPosition=90
        ComSignal_26: ComBitPosition=114, ComBitSize=1, ComDataInvalidAction=REPLACE, ComErrorNotification=Rte_COMCbkTErr_sn26, ComFirstTimeout=15.0, ComHandleId=26, ComNotification=Rte_COMCbkTAck_sn26, ComSignalDataInvalidValue=0, ComSignalEndianness=BIG_ENDIAN, ComSignalInitValue=1, ComSignalType=BOOLEAN, ComTimeout=20.0, ComTimeoutNotification=Rte_COMCbkTxTOut_sn26, ComTransferProperty=PENDING, ComUpdateBitPosition=116
        ComSignal_27: ComBitPosition=3, ComBitSize=13, ComDataInvalidAction=NOTIFY, ComErrorNotification=Rte_COMCbkTErr_sn27, ComFirstTimeout=20.0, ComHandleId=27, ComNotification=Rte_COMCbkTAck_sn27, ComSignalDataInvalidValue=8191, ComSignalEndianness=LITTLE_ENDIAN, ComSignalInitValue=255, ComSignalType=UINT16, ComTimeout=25.0, ComTimeoutNotification=Rte_COMCbkTxTOut_sn27, ComTransferProperty=TRIGGERED, ComUpdateBitPosition=1
          ComFilter: ComFilterAlgorithm=NEW_IS_OUTSIDE, ComFilterMax=8191, ComFilterMin=4096
        ComSignal_28: ComBitPosition=17, ComBitSize=11, ComDataInvalidAction=REPLACE, ComErrorNotification=Rte_COMCbkTErr_sn28, ComFirstTimeout=15.0, ComHandleId=28, ComNotification=Rte_COMCbkTAck_sn28, ComSignalDataInvalidValue=273, ComSignalEndianness=LITTLE_ENDIAN, ComSignalInitValue=0, ComSignalType=SINT16, ComTimeout=20.0, ComTimeoutNotification=Rte_COMCbkTxTOut_sn28, ComTransferProperty=TRIGGERED, ComUpdateBitPosition=29
          ComFilter: ComFilterAlgorithm=NEW_IS_OUTSIDE, ComFilterMax=511, ComFilterMin=256
        ComSignal_29: ComBitPosition=34, ComBitSize=17, ComDataInvalidAction=NOTIFY, ComErrorNotification=Rte_COMCbkTErr_sn29, ComFirstTimeout=20.0, ComHandleId=29, ComNotification=Rte_COMCbkTAck_sn29, ComSignalDataInvalidValue=78643, ComSignalEndianness=LITTLE_ENDIAN, ComSignalInitValue=511, ComSignalType=UINT32, ComTimeout=25.0, ComTimeoutNotification=Rte_COMCbkTxTOut_sn29, ComTransferProperty=PENDING, ComUpdateBitPosition=51
          ComFilter: ComFilterAlgorithm=NEW_IS_OUTSIDE, ComFilterMax=30583, ComFilterMin=4369
        ComSignal_30: ComBitPosition=53, ComBitSize=11, ComDataInvalidAction=REPLACE, ComErrorNotification=Rte_COMCbkTErr_sn30, ComFirstTimeout=15.0, ComHandleId=30, ComNotification=Rte_COMCbkTAck_sn30, ComSignalDataInvalidValue=-888, ComSignalEndianness=LITTLE_ENDIAN, ComSignalInitValue=273, ComSignalType=SINT32, ComTimeout=20.0, ComTimeoutNotification=Rte_COMCbkTxTOut_sn30, ComTransferProperty=PENDING, ComUpdateBitPosition=65
          ComFilter: ComFilterAlgorithm=NEW_IS_OUTSIDE, ComFilterMax=768, ComFilterMin=512
        ComSignal_31: ComBitPosition=68, ComBitSize=4, ComDataInvalidAction=NOTIFY, ComErrorNotification=Rte_COMCbkTErr_sn31, ComFirstTimeout=20.0, ComHandleId=31, ComNotification=Rte_COMCbkTAck_sn31, ComSignalDataInvalidValue=0, ComSignalEndianness=BIG_ENDIAN, ComSignalInitValue=10, ComSignalType=UINT8, ComTimeout=25.0, ComTimeoutNotification=Rte_COMCbkTxTOut_sn31, ComTransferProperty=TRIGGERED, ComUpdateBitPosition=67
          ComFilter: ComFilterAlgorithm=NEW_IS_OUTSIDE, ComFilterMax=10, ComFilterMin=5
        ComSignal_32: ComBitPosition=72, ComBitSize=8, ComDataInvalidAction=NOTIFY, ComErrorNotification=Rte_COMCbkTErr_sn32, ComFirstTimeout=15.0, ComHandleId=32, ComNotification=Rte_COMCbkTAck_sn32, ComSignalDataInvalidValue=-128, ComSignalEndianness=BIG_ENDIAN, ComSignalInitValue=-52, ComSignalType=SINT8, ComTimeout=20.0, ComTimeoutNotification=Rte_COMCbkTxTOut_sn32, ComTransferProperty=PENDING, ComUpdateBitPosition=87
          ComFilter: ComFilterAlgorithm=NEW_IS_OUTSIDE, ComFilterMax=175, ComFilterMin=170
        ComSignal_33: ComBitPosition=92, ComBitSize=9, ComDataInvalidAction=REPLACE, ComErrorNotification=Rte_COMCbkTErr_sn33, ComFirstTimeout=20.0, ComHandleId=33, ComNotification=Rte_COMCbkTAck_sn33, ComSignalDataInvalidValue=256, ComSignalEndianness=BIG_ENDIAN, ComSignalInitValue=5, ComSignalType=UINT16, ComTimeout=25.0, ComTimeoutNotification=Rte_COMCbkTxTOut_sn33, ComTransferProperty=TRIGGERED, ComUpdateBitPosition=85
        ComSignal_34: ComBitPosition=104, ComBitSize=18, ComDataInvalidAction=NOTIFY, ComErrorNotification=Rte_COMCbkTErr_sn34, ComFirstTimeout=15.0, ComHandleId=34, ComNotification=Rte_COMCbkTAck_sn34, ComSignalDataInvalidValue=61166, ComSignalEndianness=BIG_ENDIAN, ComSignalInitValue=375, ComSignalType=UINT32, ComTimeout=20.0, ComTimeoutNotification=Rte_COMCbkTxTOut_sn34, ComTransferProperty=TRIGGERED, ComUpdateBitPosition=90
        ComSignal_35: ComBitPosition=114, ComBitSize=1, ComDataInvalidAction=REPLACE, ComErrorNotification=Rte_COMCbkTErr_sn35, ComFirstTimeout=20.0, ComHandleId=35, ComNotification=Rte_COMCbkTAck_sn35, ComSignalDataInvalidValue=0, ComSignalEndianness=BIG_ENDIAN, ComSignalInitValue=1, ComSignalType=BOOLEAN, ComTimeout=25.0, ComTimeoutNotification=Rte_COMCbkTxTOut_sn35, ComTransferProperty=TRIGGERED_ON_CHANGE, ComUpdateBitPosition=116
        ComSignal_36: ComBitPosition=3, ComBitSize=15, ComDataInvalidAction=NOTIFY, ComErrorNotification=Rte_COMCbkTErr_sn36, ComFirstTimeout=15.0, ComHandleId=36, ComNotification=Rte_COMCbkTAck_sn36, ComSignalDataInvalidValue=62, ComSignalEndianness=LITTLE_ENDIAN, ComSignalInitValue=-16384, ComSignalType=SINT32, ComTimeout=20.0, ComTimeoutNotification=Rte_COMCbkTxTOut_sn36, ComTransferProperty=TRIGGERED
          ComFilter: ComFilterAlgorithm=MASKED_NEW_DIFFERS_MASKED_OLD, ComFilterMask=8191
        ComSignal_37: ComBitPosition=21, ComBitSize=3, ComDataInvalidAction=NOTIFY, ComErrorNotification=Rte_COMCbkTErr_sn37, ComFirstTimeout=20.0, ComHandleId=37, ComNotification=Rte_COMCbkTAck_sn37, ComSignalDataInvalidValue=7, ComSignalEndianness=BIG_ENDIAN, ComSignalInitValue=1, ComSignalType=UINT8, ComTimeout=25.0, ComTimeoutNotification=Rte_COMCbkTxTOut_sn37, ComTransferProperty=TRIGGERED
          ComFilter: ComFilterAlgorithm=MASKED_NEW_DIFFERS_MASKED_OLD, ComFilterMask=3
        ComSignal_38: ComBitPosition=42, ComBitSize=12, ComDataInvalidAction=NOTIFY, ComErrorNotification=Rte_COMCbkTErr_sn38, ComFirstTimeout=15.0, ComHandleId=38, ComNotification=Rte_COMCbkTAck_sn38, ComSignalDataInvalidValue=0, ComSignalEndianness=BIG_ENDIAN, ComSignalInitValue=4095, ComSignalType=UINT16, ComTimeout=20.0, ComTimeoutNotification=Rte_COMCbkTxTOut_sn38, ComTransferProperty=TRIGGERED
          ComFilter: ComFilterAlgorithm=MASKED_NEW_DIFFERS_MASKED_OLD, ComFilterMask=240
        ComSignal_39: ComBitPosition=48, ComBitSize=15, ComDataInvalidAction=NOTIFY, ComErrorNotification=Rte_COMCbkTErr_sn39, ComFirstTimeout=25.0, ComHandleId=39, ComNotification=Rte_COMCbkTAck_sn39, ComSignalDataInvalidValue=1228, ComSignalEndianness=LITTLE_ENDIAN, ComSignalInitValue=0, ComSignalType=UINT16, ComTimeout=200.0, ComTimeoutNotification=Rte_COMCbkTxTOut_sn39, ComTransferProperty=TRIGGERED
          ComFilter: ComFilterAlgorithm=MASKED_NEW_DIFFERS_MASKED_OLD, ComFilterMask=255
        ComSignal_40: ComBitPosition=64, ComBitSize=1, ComDataInvalidAction=NOTIFY, ComErrorNotification=Rte_COMCbkTErr_sn40, ComFirstTimeout=250.0, ComHandleId=40, ComNotification=Rte_COMCbkTAck_sn40, ComSignalDataInvalidValue=1, ComSignalEndianness=BIG_ENDIAN, ComSignalInitValue=0, ComSignalType=BOOLEAN, ComTimeout=20.0, ComTimeoutNotification=Rte_COMCbkTxTOut_sn40, ComTransferProperty=TRIGGERED
          ComFilter: ComFilterAlgorithm=MASKED_NEW_DIFFERS_MASKED_OLD, ComFilterMask=1
        ComSignal_41: ComBitPosition=68, ComBitSize=11, ComDataInvalidAction=NOTIFY, ComErrorNotification=Rte_COMCbkTErr_sn41, ComFirstTimeout=20.0, ComHandleId=41, ComNotification=Rte_COMCbkTAck_sn41, ComSignalDataInvalidValue=1365, ComSignalEndianness=LITTLE_ENDIAN, ComSignalInitValue=682, ComSignalType=UINT16, ComTimeout=25.0, ComTimeoutNotification=Rte_COMCbkTxTOut_sn41, ComTransferProperty=TRIGGERED
          ComFilter: ComFilterAlgorithm=MASKED_NEW_DIFFERS_MASKED_OLD, ComFilterMask=783
        ComSignal_42: ComBitPosition=82, ComBitSize=11, ComDataInvalidAction=NOTIFY, ComErrorNotification=Rte_COMCbkTErr_sn42, ComFirstTimeout=15.0, ComHandleId=42, ComNotification=Rte_COMCbkTAck_sn42, ComSignalDataInvalidValue=0, ComSignalEndianness=LITTLE_ENDIAN, ComSignalInitValue=32, ComSignalType=SINT16, ComTimeout=20.0, ComTimeoutNotification=Rte_COMCbkTxTOut_sn42, ComTransferProperty=TRIGGERED
          ComFilter: ComFilterAlgorithm=MASKED_NEW_DIFFERS_MASKED_OLD, ComFilterMask=1024
        ComSignal_43: ComBitPosition=110, ComBitSize=10, ComDataInvalidAction=NOTIFY, ComErrorNotification=Rte_COMCbkTErr_sn43, ComFirstTimeout=20.0, ComHandleId=43, ComNotification=Rte_COMCbkTAck_sn43, ComSignalDataInvalidValue=42, ComSignalEndianness=BIG_ENDIAN, ComSignalInitValue=64, ComSignalType=UINT32, ComTimeout=25.0, ComTimeoutNotification=Rte_COMCbkTxTOut_sn43, ComTransferProperty=TRIGGERED
          ComFilter: ComFilterAlgorithm=MASKED_NEW_DIFFERS_MASKED_OLD, ComFilterMask=63
        ComSignal_44: ComBitPosition=116, ComBitSize=6, ComDataInvalidAction=NOTIFY, ComErrorNotification=Rte_COMCbkTErr_sn44, ComFirstTimeout=15.0, ComHandleId=44, ComNotification=Rte_COMCbkTAck_sn44, ComSignalDataInvalidValue=1, ComSignalEndianness=LITTLE_ENDIAN, ComSignalInitValue=0, ComSignalType=SINT8, ComTimeout=20.0, ComTimeoutNotification=Rte_COMCbkTxTOut_sn44, ComTransferProperty=TRIGGERED
          ComFilter: ComFilterAlgorithm=MASKED_NEW_DIFFERS_MASKED_OLD, ComFilterMask=62
        ComSignal_45: ComBitPosition=4, ComBitSize=4, ComDataInvalidAction=NOTIFY, ComErrorNotification=Rte_COMCbkTErr_sn45, ComHandleId=45, ComNotification=Rte_COMCbkTAck_sn45, ComSignalDataInvalidValue=10, ComSignalEndianness=LITTLE_ENDIAN, ComSignalInitValue=11, ComSignalType=UINT8, ComTimeoutNotification=Rte_COMCbkTxTOut_sn45, ComTransferProperty=TRIGGERED, ComUpdateBitPosition=2
          ComFilter: ComFilterAlgorithm=ONE_EVERY_N, ComFilterOffset=4, ComFilterPeriod=5
        ComSignal_46: ComBitPosition=18, ComBitSize=13, ComDataInvalidAction=NOTIFY, ComErrorNotification=Rte_COMCbkTErr_sn46, ComHandleId=46, ComNotification=Rte_COMCbkTAck_sn46, ComSignalDataInvalidValue=4369, ComSignalEndianness=BIG_ENDIAN, ComSignalInitValue=8191, ComSignalType=UINT16, ComTimeoutNotification=Rte_COMCbkTxTOut_sn46, ComTransferProperty=TRIGGERED, ComUpdateBitPosition=15
          ComFilter: ComFilterAlgorithm=ONE_EVERY_N, ComFilterOffset=5, ComFilterPeriod=10
        ComSignal_47: ComBitPosition=25, ComBitSize=20, ComDataInvalidAction=NOTIFY, ComErrorNotification=Rte_COMCbkTErr_sn47, ComHandleId=47, ComNotification=Rte_COMCbkTAck_sn47, ComSignalDataInvalidValue=489335, ComSignalEndianness=LITTLE_ENDIAN, ComSignalInitValue=279620, ComSignalType=UINT32, ComTimeoutNotification=Rte_COMCbkTxTOut_sn47, ComTransferProperty=TRIGGERED, ComUpdateBitPosition=45
          ComFilter: ComFilterAlgorithm=ONE_EVERY_N, ComFilterOffset=6, ComFilterPeriod=7
        ComSignal_48: ComBitPosition=48, ComBitSize=7, ComDataInvalidAction=NOTIFY, ComErrorNotification=Rte_COMCbkTErr_sn48, ComHandleId=48, ComNotification=Rte_COMCbkTAck_sn48, ComSignalDataInvalidValue=-1, ComSignalEndianness=BIG_ENDIAN, ComSignalInitValue=-64, ComSignalType=SINT16, ComTimeoutNotification=Rte_COMCbkTxTOut_sn48, ComTransferProperty=TRIGGERED, ComUpdateBitPosition=55
          ComFilter: ComFilterAlgorithm=ONE_EVERY_N, ComFilterOffset=4, ComFilterPeriod=5
        ComSignal_49: ComBitPosition=57, ComBitSize=6, ComDataInvalidAction=NOTIFY, ComErrorNotification=Rte_COMCbkTErr_sn49, ComHandleId=49, ComNotification=Rte_COMCbkTAck_sn49, ComSignalDataInvalidValue=15, ComSignalEndianness=LITTLE_ENDIAN, ComSignalInitValue=1, ComSignalType=UINT16, ComTimeoutNotification=Rte_COMCbkTxTOut_sn49, ComTransferProperty=TRIGGERED, ComUpdateBitPosition=63
          ComFilter: ComFilterAlgorithm=ONE_EVERY_N, ComFilterOffset=3, ComFilterPeriod=4
        ComSignal_50: ComBitPosition=64, ComBitSize=5, ComDataInvalidAction=NOTIFY, ComErrorNotification=Rte_COMCbkTErr_sn50, ComHandleId=50, ComNotification=Rte_COMCbkTAck_sn50, ComSignalDataInvalidValue=1, ComSignalEndianness=BIG_ENDIAN, ComSignalInitValue=-1, ComSignalType=SINT8, ComTimeoutNotification=Rte_COMCbkTxTOut_sn50, ComTransferProperty=TRIGGERED, ComUpdateBitPosition=69
          ComFilter: ComFilterAlgorithm=ONE_EVERY_N, ComFilterOffset=4, ComFilterPeriod=6
        ComSignal_51: ComBitPosition=73, ComBitSize=13, ComDataInvalidAction=NOTIFY, ComErrorNotification=Rte_COMCbkTErr_sn51, ComHandleId=51, ComNotification=Rte_COMCbkTAck_sn51, ComSignalDataInvalidValue=-256, ComSignalEndianness=LITTLE_ENDIAN, ComSignalInitValue=0, ComSignalType=SINT32, ComTimeoutNotification=Rte_COMCbkTxTOut_sn51, ComTransferProperty=TRIGGERED, ComUpdateBitPosition=86
          ComFilter: ComFilterAlgorithm=ONE_EVERY_N, ComFilterOffset=5, ComFilterPeriod=8
        ComSignal_52: ComBitPosition=88, ComBitSize=7, ComDataInvalidAction=NOTIFY, ComErrorNotification=Rte_COMCbkTErr_sn52, ComHandleId=52, ComNotification=Rte_COMCbkTAck_sn52, ComSignalDataInvalidValue=119, ComSignalEndianness=BIG_ENDIAN, ComSignalInitValue=63, ComSignalType=UINT32, ComTimeoutNotification=Rte_COMCbkTxTOut_sn52, ComTransferProperty=TRIGGERED, ComUpdateBitPosition=95
          ComFilter: ComFilterAlgorithm=ONE_EVERY_N, ComFilterOffset=4, ComFilterPeriod=8
        ComSignal_53: ComBitPosition=96, ComDataInvalidAction=NOTIFY, ComErrorNotification=Rte_COMCbkTErr_sn53, ComHandleId=53, ComSignalDataInvalidValue=0x41 0x54 0x4B, ComSignalEndianness=opaque, ComSignalInitValue=0x41 0x54 0x4B, ComSignalLength=3, ComSignalType=UINT8_N, ComTimeoutNotification=Rte_COMCbkTxTOut_sn53, ComTransferProperty=TRIGGERED, ComUpdateBitPosition=120
          ComFilter: ComFilterAlgorithm=ALWAYS
        ComSignal_54: ComBitPosition=122, ComBitSize=1, ComDataInvalidAction=NOTIFY, ComErrorNotification=Rte_COMCbkTErr_sn54, ComHandleId=54, ComNotification=Rte_COMCbkTAck_sn54, ComSignalDataInvalidValue=0, ComSignalEndianness=LITTLE_ENDIAN, ComSignalInitValue=1, ComSignalType=BOOLEAN, ComTimeoutNotification=Rte_COMCbkTxTOut_sn54, ComTransferProperty=TRIGGERED, ComUpdateBitPosition=121
          ComFilter: ComFilterAlgorithm=ONE_EVERY_N, ComFilterOffset=5, ComFilterPeriod=7
        ComSignal_55: ComBitPosition=3, ComBitSize=5, ComDataInvalidAction=NOTIFY, ComErrorNotification=Rte_COMCbkTErr_sn55, ComFirstTimeout=20.0, ComHandleId=55, ComNotification=Rte_COMCbkTAck_sn55, ComSignalDataInvalidValue=1, ComSignalEndianness=LITTLE_ENDIAN, ComSignalInitValue=-1, ComSignalType=SINT8, ComTimeoutNotification=Rte_COMCbkTxTOut_sn55, ComTransferProperty=TRIGGERED
          ComFilter: ComFilterAlgorithm=ALWAYS
        ComSignal_56: ComBitPosition=10, ComBitSize=6, ComDataInvalidAction=NOTIFY, ComErrorNotification=Rte_COMCbkTErr_sn56, ComFirstTimeout=15.0, ComHandleId=56, ComNotification=Rte_COMCbkTAck_sn56, ComSignalDataInvalidValue=47, ComSignalEndianness=LITTLE_ENDIAN, ComSignalInitValue=3, ComSignalType=UINT8, ComTimeoutNotification=Rte_COMCbkTxTOut_sn56, ComTransferProperty=TRIGGERED
          ComFilter: ComFilterAlgorithm=ALWAYS
        ComSignal_57: ComBitPosition=26, ComBitSize=6, ComDataInvalidAction=NOTIFY, ComErrorNotification=Rte_COMCbkTErr_sn57, ComFirstTimeout=20.0, ComHandleId=57, ComNotification=Rte_COMCbkTAck_sn57, ComSignalDataInvalidValue=-1, ComSignalEndianness=LITTLE_ENDIAN, ComSignalInitValue=-4, ComSignalType=SINT32, ComTimeoutNotification=Rte_COMCbkTxTOut_sn57, ComTransferProperty=TRIGGERED
          ComFilter: ComFilterAlgorithm=ALWAYS
        ComSignal_58: ComBitPosition=42, ComBitSize=14, ComDataInvalidAction=NOTIFY, ComErrorNotification=Rte_COMCbkTErr_sn58, ComFirstTimeout=15.0, ComHandleId=58, ComNotification=Rte_COMCbkTAck_sn58, ComSignalDataInvalidValue=4369, ComSignalEndianness=BIG_ENDIAN, ComSignalInitValue=13107, ComSignalType=UINT32, ComTimeoutNotification=Rte_COMCbkTxTOut_sn58, ComTransferProperty=PENDING
          ComFilter: ComFilterAlgorithm=ALWAYS
        ComSignal_59: ComBitPosition=48, ComBitSize=12, ComDataInvalidAction=NOTIFY, ComErrorNotification=Rte_COMCbkTErr_sn59, ComFirstTimeout=20.0, ComHandleId=59, ComNotification=Rte_COMCbkTAck_sn59, ComSignalDataInvalidValue=1092, ComSignalEndianness=LITTLE_ENDIAN, ComSignalInitValue=-1912, ComSignalType=SINT16, ComTimeoutNotification=Rte_COMCbkTxTOut_sn59, ComTransferProperty=PENDING
          ComFilter: ComFilterAlgorithm=ALWAYS
        ComSignal_60: ComBitPosition=62, ComBitSize=10, ComDataInvalidAction=NOTIFY, ComErrorNotification=Rte_COMCbkTErr_sn60, ComFirstTimeout=15.0, ComHandleId=60, ComNotification=Rte_COMCbkTAck_sn60, ComSignalDataInvalidValue=1023, ComSignalEndianness=LITTLE_ENDIAN, ComSignalInitValue=160, ComSignalType=UINT16, ComTimeoutNotification=Rte_COMCbkTxTOut_sn60, ComTransferProperty=PENDING
          ComFilter: ComFilterAlgorithm=ALWAYS
        ComSignal_61: ComBitPosition=90, ComBitSize=14, ComDataInvalidAction=NOTIFY, ComErrorNotification=Rte_COMCbkTErr_sn61, ComFirstTimeout=20.0, ComHandleId=61, ComNotification=Rte_COMCbkTAck_sn61, ComSignalDataInvalidValue=0, ComSignalEndianness=BIG_ENDIAN, ComSignalInitValue=4352, ComSignalType=UINT16, ComTimeoutNotification=Rte_COMCbkTxTOut_sn61, ComTransferProperty=PENDING
          ComFilter: ComFilterAlgorithm=ALWAYS
        ComSignal_62: ComBitPosition=112, ComBitSize=17, ComDataInvalidAction=NOTIFY, ComErrorNotification=Rte_COMCbkTErr_sn62, ComFirstTimeout=15.0, ComHandleId=62, ComNotification=Rte_COMCbkTAck_sn62, ComSignalDataInvalidValue=1, ComSignalEndianness=BIG_ENDIAN, ComSignalInitValue=65535, ComSignalType=UINT32, ComTimeoutNotification=Rte_COMCbkTxTOut_sn62, ComTransferProperty=PENDING
          ComFilter: ComFilterAlgorithm=ALWAYS
        ComSignal_63: ComBitPosition=97, ComBitSize=1, ComDataInvalidAction=NOTIFY, ComErrorNotification=Rte_COMCbkTErr_sn63, ComFirstTimeout=15.0, ComHandleId=63, ComNotification=Rte_COMCbkTAck_sn63, ComSignalDataInvalidValue=1, ComSignalEndianness=LITTLE_ENDIAN, ComSignalInitValue=0, ComSignalType=BOOLEAN, ComTimeoutNotification=Rte_COMCbkTxTOut_sn63, ComTransferProperty=PENDING
          ComFilter: ComFilterAlgorithm=ALWAYS
        ComSignal_64: ComBitPosition=120, ComDataInvalidAction=NOTIFY, ComErrorNotification=Rte_COMCbkTErr_sn64, ComFirstTimeout=15.0, ComHandleId=64, ComNotification=Rte_COMCbkTAck_sn64, ComSignalDataInvalidValue=0x00 0x00 0x00 0x00 0x00 0x41 0x54 0x4B, ComSignalEndianness=opaque, ComSignalInitValue=0x00 0x00 0x00 0x00 0x00 0x41 0x54 0x4B, ComSignalLength=8, ComSignalType=UINT8_N, ComTimeoutNotification=Rte_COMCbkTxTOut_sn64, ComTransferProperty=PENDING
          ComFilter: ComFilterAlgorithm=ALWAYS
        ComSignal_65: ComBitPosition=3, ComBitSize=5, ComDataInvalidAction=REPLACE, ComErrorNotification=Rte_COMCbkTErr_sn65, ComFirstTimeout=20.0, ComHandleId=74, ComNotification=Rte_COMCbkTAck_sn65, ComSignalDataInvalidValue=1, ComSignalEndianness=LITTLE_ENDIAN, ComSignalInitValue=-1, ComSignalType=SINT8, ComTimeout=25.0, ComTimeoutNotification=Rte_COMCbkTxTOut_sn65, ComTransferProperty=TRIGGERED
          ComFilter: ComFilterAlgorithm=NEVER
        ComSignal_66: ComBitPosition=10, ComBitSize=6, ComDataInvalidAction=REPLACE, ComErrorNotification=Rte_COMCbkTErr_sn66, ComFirstTimeout=10.0, ComHandleId=66, ComNotification=Rte_COMCbkTAck_sn66, ComSignalDataInvalidValue=47, ComSignalEndianness=LITTLE_ENDIAN, ComSignalInitValue=3, ComSignalType=UINT8, ComTimeout=20.0, ComTimeoutNotification=Rte_COMCbkTxTOut_sn66, ComTransferProperty=TRIGGERED
          ComFilter: ComFilterAlgorithm=NEVER
        ComSignal_67: ComBitPosition=26, ComBitSize=6, ComDataInvalidAction=REPLACE, ComErrorNotification=Rte_COMCbkTErr_sn67, ComFirstTimeout=15.0, ComHandleId=67, ComNotification=Rte_COMCbkTAck_sn67, ComSignalDataInvalidValue=-31, ComSignalEndianness=LITTLE_ENDIAN, ComSignalInitValue=30, ComSignalType=SINT32, ComTimeout=20.0, ComTimeoutNotification=Rte_COMCbkTxTOut_sn67, ComTransferProperty=TRIGGERED
          ComFilter: ComFilterAlgorithm=NEVER
        ComSignal_68: ComBitPosition=42, ComBitSize=14, ComDataInvalidAction=REPLACE, ComErrorNotification=Rte_COMCbkTErr_sn68, ComFirstTimeout=15.0, ComHandleId=68, ComNotification=Rte_COMCbkTAck_sn68, ComSignalDataInvalidValue=4369, ComSignalEndianness=BIG_ENDIAN, ComSignalInitValue=13107, ComSignalType=UINT32, ComTimeout=20.0, ComTimeoutNotification=Rte_COMCbkTxTOut_sn68, ComTransferProperty=TRIGGERED
          ComFilter: ComFilterAlgorithm=NEVER
        ComSignal_69: ComBitPosition=48, ComBitSize=12, ComDataInvalidAction=REPLACE, ComErrorNotification=Rte_COMCbkTErr_sn69, ComFirstTimeout=20.0, ComHandleId=69, ComNotification=Rte_COMCbkTAck_sn69, ComSignalDataInvalidValue=1092, ComSignalEndianness=LITTLE_ENDIAN, ComSignalInitValue=-1912, ComSignalType=SINT16, ComTimeout=25.0, ComTimeoutNotification=Rte_COMCbkTxTOut_sn69, ComTransferProperty=TRIGGERED
          ComFilter: ComFilterAlgorithm=NEVER
        ComSignal_70: ComBitPosition=62, ComBitSize=10, ComDataInvalidAction=REPLACE, ComErrorNotification=Rte_COMCbkTErr_sn70, ComFirstTimeout=15.0, ComHandleId=70, ComNotification=Rte_COMCbkTAck_sn70, ComSignalDataInvalidValue=1023, ComSignalEndianness=LITTLE_ENDIAN, ComSignalInitValue=160, ComSignalType=UINT16, ComTimeout=20.0, ComTimeoutNotification=Rte_COMCbkTxTOut_sn70, ComTransferProperty=TRIGGERED
          ComFilter: ComFilterAlgorithm=NEVER
        ComSignal_71: ComBitPosition=90, ComBitSize=14, ComDataInvalidAction=REPLACE, ComErrorNotification=Rte_COMCbkTErr_sn71, ComFirstTimeout=20.0, ComHandleId=71, ComNotification=Rte_COMCbkTAck_sn71, ComSignalDataInvalidValue=0, ComSignalEndianness=BIG_ENDIAN, ComSignalInitValue=4352, ComSignalType=UINT16, ComTimeout=25.0, ComTimeoutNotification=Rte_COMCbkTxTOut_sn71, ComTransferProperty=TRIGGERED
          ComFilter: ComFilterAlgorithm=NEVER
        ComSignal_72: ComBitPosition=112, ComBitSize=17, ComDataInvalidAction=REPLACE, ComErrorNotification=Rte_COMCbkTErr_sn72, ComFirstTimeout=15.0, ComHandleId=72, ComNotification=Rte_COMCbkTAck_sn72, ComSignalDataInvalidValue=1, ComSignalEndianness=BIG_ENDIAN, ComSignalInitValue=65535, ComSignalType=UINT32, ComTimeout=20.0, ComTimeoutNotification=Rte_COMCbkTxTOut_sn72, ComTransferProperty=TRIGGERED
          ComFilter: ComFilterAlgorithm=NEVER
        ComSignal_73: ComBitPosition=97, ComBitSize=1, ComDataInvalidAction=REPLACE, ComErrorNotification=Rte_COMCbkTErr_sn73, ComFirstTimeout=20.0, ComHandleId=73, ComNotification=Rte_COMCbkTAck_sn73, ComSignalDataInvalidValue=1, ComSignalEndianness=LITTLE_ENDIAN, ComSignalInitValue=0, ComSignalType=BOOLEAN, ComTimeout=25.0, ComTimeoutNotification=Rte_COMCbkTxTOut_sn73, ComTransferProperty=TRIGGERED
          ComFilter: ComFilterAlgorithm=NEVER
        ComSignal_74: ComBitPosition=120, ComDataInvalidAction=REPLACE, ComErrorNotification=Rte_COMCbkTErr_sn74, ComFirstTimeout=15.0, ComHandleId=65, ComNotification=Rte_COMCbkTAck_sn74, ComSignalDataInvalidValue=0x00 0x00 0x00 0x00 0x00 0x41 0x54 0x4B, ComSignalEndianness=opaque, ComSignalInitValue=0x00 0x00 0x00 0x00 0x00 0x41 0x54 0x4B, ComSignalLength=8, ComSignalType=UINT8_N, ComTimeout=20.0, ComTimeoutNotification=Rte_COMCbkTxTOut_sn74, ComTransferProperty=TRIGGERED
          ComFilter: ComFilterAlgorithm=NEVER
        ComSignal_75: ComBitPosition=0, ComDataInvalidAction=REPLACE, ComErrorNotification=Rte_COMCbkTErr_sn75, ComFirstTimeout=15.0, ComHandleId=75, ComNotification=Rte_COMCbkTAck_sn75, ComSignalEndianness=opaque, ComSignalInitValue=65, ComSignalLength=1, ComSignalType=UINT8_N, ComTimeout=20.0, ComTimeoutNotification=Rte_COMCbkTxTOut_sn75, ComTransferProperty=TRIGGERED
        ComSignal_76: ComBitPosition=8, ComBitSize=2, ComDataInvalidAction=REPLACE, ComErrorNotification=Rte_COMCbkTErr_sn76, ComFirstTimeout=15.0, ComHandleId=76, ComNotification=Rte_COMCbkTAck_sn76, ComSignalEndianness=LITTLE_ENDIAN, ComSignalInitValue=1, ComSignalType=UINT8, ComTimeout=20.0, ComTimeoutNotification=Rte_COMCbkTxTOut_sn76, ComTransferProperty=PENDING
        ComSignal_77: ComBitPosition=13, ComBitSize=1, ComErrorNotification=Rte_COMCbkTErr_sn77, ComFirstTimeout=15.0, ComHandleId=77, ComNotification=Rte_COMCbkTAck_sn77, ComSignalEndianness=LITTLE_ENDIAN, ComSignalInitValue=1, ComSignalType=BOOLEAN, ComTimeout=20.0, ComTimeoutNotification=Rte_COMCbkTxTOut_sn77, ComTransferProperty=TRIGGERED
          ComFilter: ComFilterAlgorithm=NEVER
        ComSignal_78: ComBitPosition=14, ComBitSize=1, ComErrorNotification=Rte_COMCbkTErr_sn78, ComFirstTimeout=15.0, ComHandleId=78, ComNotification=Rte_COMCbkTAck_sn78, ComSignalEndianness=LITTLE_ENDIAN, ComSignalInitValue=0, ComSignalType=BOOLEAN, ComTimeout=20.0, ComTimeoutNotification=Rte_COMCbkTxTOut_sn78, ComTransferProperty=TRIGGERED
          ComFilter: ComFilterAlgorithm=ALWAYS
        ComSignal_79: ComBitPosition=40, ComBitSize=32, ComDataInvalidAction=REPLACE, ComErrorNotification=Rte_COMCbkTErr_sn79, ComFirstTimeout=20.0, ComHandleId=79, ComNotification=Rte_COMCbkTAck_sn79, ComSignalDataInvalidValue=0.0, ComSignalEndianness=LITTLE_ENDIAN, ComSignalInitValue=4352.0, ComSignalType=FLOAT32, ComTimeout=25.0, ComTimeoutNotification=Rte_COMCbkTxTOut_sn79, ComTransferProperty=TRIGGERED
        ComSignal_80: ComBitPosition=128, ComBitSize=64, ComDataInvalidAction=REPLACE, ComErrorNotification=Rte_COMCbkTErr_sn80, ComFirstTimeout=15.0, ComHandleId=80, ComNotification=Rte_COMCbkTAck_sn80, ComSignalDataInvalidValue=1.0, ComSignalEndianness=BIG_ENDIAN, ComSignalInitValue=65535.0, ComSignalType=FLOAT64, ComTimeout=20.0, ComTimeoutNotification=Rte_COMCbkTxTOut_sn80, ComTransferProperty=TRIGGERED
        ComSignal_81: ComBitPosition=1, ComBitSize=1, ComDataInvalidAction=REPLACE, ComFirstTimeout=15.0, ComHandleId=81, ComSignalDataInvalidValue=1, ComSignalEndianness=LITTLE_ENDIAN, ComSignalInitValue=0, ComSignalType=BOOLEAN, ComTransferProperty=TRIGGERED
        ComSignal_82: ComBitPosition=0, ComDataInvalidAction=REPLACE, ComErrorNotification=Rte_COMCbkTErr_sn82, ComFirstTimeout=15.0, ComHandleId=82, ComNotification=Rte_COMCbkTAck_sn82, ComSignalEndianness=opaque, ComSignalInitValue=65, ComSignalLength=1, ComSignalType=UINT8_N, ComTimeout=20.0, ComTimeoutNotification=Rte_COMCbkTxTOut_sn82, ComTransferProperty=TRIGGERED
          ComFilter: ComFilterAlgorithm=NEVER
        ComSignal_83: ComBitPosition=3, ComBitSize=5, ComDataInvalidAction=REPLACE, ComErrorNotification=Rte_COMCbkTErr_sn83, ComFirstTimeout=20.0, ComHandleId=83, ComNotification=Rte_COMCbkTAck_sn83, ComSignalDataInvalidValue=5, ComSignalEndianness=BIG_ENDIAN, ComSignalInitValue=1, ComSignalType=UINT8, ComTimeout=25.0, ComTimeoutNotification=Rte_COMCbkTxTOut_sn35, ComTransferProperty=TRIGGERED_ON_CHANGE, ComUpdateBitPosition=20
          ComFilter: ComFilterAlgorithm=NEVER
      ComTimeBase: ComTxTimeBase=0.2
    ComGeneral: ComSupportedIPduGroups=1, ComVersionInfoApi=true, ComConfigurationUseDet=true
package /EcuC
  module config EcuC: ecuc-def-edition=4.2.0, implementation-config-variant=VARIANT-PRE-COMPILE
    EcucPduCollection
      12 x Pdu:
        Pdu_0: PduLength=15
        Pdu_1: PduLength=15
        Pdu_{2..5}: PduLength=16
        Pdu_6: PduLength=25
        Pdu_7: PduLength=25
        Pdu_8: PduLength=18
        Pdu_9: PduLength=16
        Pdu_10: PduLength=16
        Pdu_11: PduLength=10
package /PduR
  module config PduR: ecuc-def-edition=4.2.0, implementation-config-variant=VARIANT-PRE-COMPILE
    PduRGeneral: PduRZeroCostOperation=true
    PduRRoutingTables: PduRConfigurationId=0
      PduRRoutingTable
        12 x PduRRoutingPath:
          PduRRoutingPath_0
            PduRSrcPdu: PduRSourcePduHandleId=0, PduRSrcPduRef=Pdu_0
          PduRRoutingPath_1
            PduRSrcPdu: PduRSourcePduHandleId=1, PduRSrcPduRef=Pdu_1
          PduRRoutingPath_2
            PduRSrcPdu: PduRSourcePduHandleId=2, PduRSrcPduRef=Pdu_2
          PduRRoutingPath_3
            PduRSrcPdu: PduRSourcePduHandleId=3, PduRSrcPduRef=Pdu_3
          PduRRoutingPath_4
            PduRSrcPdu: PduRSourcePduHandleId=4, PduRSrcPduRef=Pdu_4
          PduRRoutingPath_5
            PduRSrcPdu: PduRSourcePduHandleId=5, PduRSrcPduRef=Pdu_5
          PduRRoutingPath_6
            PduRSrcPdu: PduRSourcePduHandleId=6, PduRSrcPduRef=Pdu_6
          PduRRoutingPath_7
            PduRSrcPdu: PduRSourcePduHandleId=7, PduRSrcPduRef=Pdu_7
          PduRRoutingPath_8
            PduRSrcPdu: PduRSourcePduHandleId=8, PduRSrcPduRef=Pdu_8
          PduRRoutingPath_9
            PduRSrcPdu: PduRSourcePduHandleId=9, PduRSrcPduRef=Pdu_9
          PduRRoutingPath_10
            PduRSrcPdu: PduRSourcePduHandleId=10, PduRSrcPduRef=Pdu_10
          PduRRoutingPath_11
            PduRSrcPdu: PduRSourcePduHandleId=11, PduRSrcPduRef=Pdu_11
