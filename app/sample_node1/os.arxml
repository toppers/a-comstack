AUTOSAR XML (schema 4-0-3)
package /Os
  module config Os: ecuc-def-edition=4.2.0, implementation-config-variant=VARIANT-PRE-COMPILE
    MainApp (OsAppMode)
    OsOS: OsStackMonitoring=true, OsStatus=EXTENDED, OsUseGetServiceId=true, OsUseParameterAccess=true, OsScalabilityClass=SC1
      OsHooks: OsErrorHook=false, OsPostTaskHook=false, OsPreTaskHook=false, OsProtectionHook=true, OsShutdownHook=false, OsStartupHook=false
      OsHookStack: OsHookStackSize=4096
      OsOsStack: OsOsStackSize=8192
    MainTask (OsTask): OsTaskActivation=1, OsTaskPriority=0, OsTaskSchedule=FULL, OsTaskStackSize=81920
      OsTaskAutostart: OsTaskAppModeRef=MainApp
    C2ISR_FOR_CAN (OsIsr): OsIsrCategory=CATEGORY_2, OsIsrInterruptNumber=10, OsIsrInterruptPriority=3
