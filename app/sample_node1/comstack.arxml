AUTOSAR XML (schema 4-0-3)
package /Com
  module config Com: ecuc-def-edition=4.2.0, implementation-config-variant=VARIANT-PRE-COMPILE
    ComGeneral:
      ComSupportedIPduGroups = 1
      ComVersionInfoApi = true
      ComConfigurationUseDet = true
      ComRetryFailedTransmitRequests = true
      ComEnableMDTForCyclicTransmission = true
    ComConfig_0 (ComConfig): ComConfigurationId=0
      ComTimeBase: ComTxTimeBase=0.2, ComRxTimeBase=0.1
      ComIPduGroup_0 (ComIPduGroup): ComIPduGroupHandleId=0
      ComIPdu_0 (ComIPdu):
        ComIPduDirection = SEND
        ComIPduSignalProcessing = IMMEDIATE
        ComIPduHandleId = 0
        ComIPduType = NORMAL
        ComIPduCancellationSupport = true
        ComIPduGroupRef = ComIPduGroup_0
        ComIPduSignalRef = SIGNAL_A
        ComIPduSignalGroupRef = SIGNAL_G_A
        ComPduIdRef = Pdu_A
        ComTxIPdu: ComTxIPduUnusedAreasDefault=1
          ComTxModeFalse
            ComTxMode: ComTxModeMode=DIRECT, ComTxModeNumberOfRepetitions=2, ComTxModeRepetitionPeriod=3.0
          ComTxModeTrue
            ComTxMode: ComTxModeMode=PERIODIC, ComTxModeTimeOffset=3.0, ComTxModeTimePeriod=5.0
      SIGNAL_A (ComSignal):
        ComBitPosition = 0
        ComBitSize = 8
        ComHandleId = 0
        ComFirstTimeout = 2.0
        ComTimeout = 4.0
        ComNotification = Rte_COMCbkTxAck_snA
        ComErrorNotification = Rte_COMCbkTxErr_snA
        ComTimeoutNotification = Rte_COMCbkTxTOut_snA
        ComSignalDataInvalidValue = 11
        ComSignalEndianness = LITTLE_ENDIAN
        ComSignalInitValue = 1
        ComSignalType = UINT8
        ComTransferProperty = TRIGGERED_ON_CHANGE
        ComFilter: ComFilterAlgorithm=MASKED_NEW_DIFFERS_MASKED_OLD, ComFilterMask=1
      SIGNAL_G_A (ComSignalGroup):
        ComHandleId = 0
        ComTransferProperty = TRIGGERED_ON_CHANGE
        ComFirstTimeout = 2.0
        ComTimeout = 4.0
        ComNotification = Rte_COMCbkTxAck_sgA
        ComErrorNotification = Rte_COMCbkTxErr_sgA
        ComTimeoutNotification = Rte_COMCbkTxTOut_sgA
        SIGNAL_B (ComGroupSignal):
          ComBitPosition = 8
          ComBitSize = 8
          ComHandleId = 1
          ComSignalDataInvalidValue = 22
          ComSignalEndianness = LITTLE_ENDIAN
          ComSignalInitValue = 2
          ComSignalType = UINT8
          ComTransferProperty = TRIGGERED_ON_CHANGE
          ComFilter: ComFilterAlgorithm=MASKED_NEW_EQUALS_X, ComFilterMask=28, ComFilterX=28
        SIGNAL_C (ComGroupSignal):
          ComBitPosition = 16
          ComBitSize = 8
          ComHandleId = 2
          ComSignalDataInvalidValue = 33
          ComSignalEndianness = LITTLE_ENDIAN
          ComSignalInitValue = 3
          ComSignalType = UINT8
          ComTransferProperty = TRIGGERED_ON_CHANGE
          ComFilter: ComFilterAlgorithm=MASKED_NEW_EQUALS_X, ComFilterMask=28, ComFilterX=28
      ComIPdu_1 (ComIPdu):
        ComIPduDirection = RECEIVE
        ComIPduSignalProcessing = IMMEDIATE
        ComIPduHandleId = 1
        ComIPduType = NORMAL
        ComIPduGroupRef = ComIPduGroup_0
        ComIPduSignalRef = SIGNAL_D
        ComIPduSignalGroupRef = SIGNAL_G_B
        ComPduIdRef = Pdu_B
      SIGNAL_D (ComSignal):
        ComBitPosition = 0
        ComBitSize = 8
        ComHandleId = 3
        ComFirstTimeout = 2.0
        ComTimeout = 4.0
        ComNotification = Rte_COMCbkRxAck_snD
        ComInvalidNotification = Rte_COMCbkInv_snD
        ComTimeoutNotification = Rte_COMCbkRxTOut_snD
        ComSignalDataInvalidValue = 44
        ComSignalEndianness = LITTLE_ENDIAN
        ComSignalInitValue = 4
        ComSignalType = UINT8
        ComTransferProperty = TRIGGERED
      SIGNAL_G_B (ComSignalGroup):
        ComHandleId = 1
        ComTransferProperty = TRIGGERED_ON_CHANGE
        ComFirstTimeout = 2.0
        ComTimeout = 4.0
        ComNotification = Rte_COMCbkRxAck_sgB
        ComInvalidNotification = Rte_COMCbkInv_sgB
        ComTimeoutNotification = Rte_COMCbkRxTOut_sgB
        SIGNAL_E (ComGroupSignal):
          ComBitPosition = 8
          ComBitSize = 8
          ComHandleId = 4
          ComSignalDataInvalidValue = 55
          ComSignalEndianness = LITTLE_ENDIAN
          ComSignalInitValue = 5
          ComSignalType = UINT8
          ComTransferProperty = TRIGGERED_ON_CHANGE
        SIGNAL_F (ComGroupSignal):
          ComBitPosition = 16
          ComBitSize = 8
          ComHandleId = 5
          ComSignalDataInvalidValue = 66
          ComSignalEndianness = LITTLE_ENDIAN
          ComSignalInitValue = 6
          ComSignalType = UINT8
          ComTransferProperty = TRIGGERED_ON_CHANGE
      ComIPdu_2 (ComIPdu):
        ComIPduDirection = SEND
        ComIPduSignalProcessing = IMMEDIATE
        ComIPduHandleId = 2
        ComIPduType = NORMAL
        ComIPduCancellationSupport = true
        ComIPduGroupRef = ComIPduGroup_0
        ComIPduSignalRef = SIGNAL_G
        ComIPduSignalGroupRef = SIGNAL_G_C
        ComPduIdRef = Pdu_C
        ComTxIPdu: ComTxIPduUnusedAreasDefault=1
          ComTxModeFalse
            ComTxMode: ComTxModeMode=DIRECT, ComTxModeNumberOfRepetitions=2, ComTxModeRepetitionPeriod=3.0
          ComTxModeTrue
            ComTxMode: ComTxModeMode=PERIODIC, ComTxModeTimeOffset=3.0, ComTxModeTimePeriod=5.0
      SIGNAL_G (ComSignal):
        ComBitPosition = 0
        ComBitSize = 8
        ComHandleId = 6
        ComFirstTimeout = 2.0
        ComTimeout = 4.0
        ComNotification = Rte_COMCbkTxAck_snG
        ComErrorNotification = Rte_COMCbkTxErr_snG
        ComTimeoutNotification = Rte_COMCbkTxTOut_snG
        ComSignalDataInvalidValue = 11
        ComSignalEndianness = LITTLE_ENDIAN
        ComSignalInitValue = 1
        ComSignalType = UINT8
        ComTransferProperty = TRIGGERED_ON_CHANGE
        ComFilter: ComFilterAlgorithm=MASKED_NEW_DIFFERS_MASKED_OLD, ComFilterMask=1
      SIGNAL_G_C (ComSignalGroup):
        ComHandleId = 2
        ComTransferProperty = TRIGGERED_ON_CHANGE
        ComFirstTimeout = 2.0
        ComTimeout = 4.0
        ComNotification = Rte_COMCbkTxAck_sgC
        ComErrorNotification = Rte_COMCbkTxErr_sgC
        ComTimeoutNotification = Rte_COMCbkTxTOut_sgC
        SIGNAL_H (ComGroupSignal):
          ComBitPosition = 8
          ComBitSize = 8
          ComHandleId = 7
          ComSignalDataInvalidValue = 22
          ComSignalEndianness = LITTLE_ENDIAN
          ComSignalInitValue = 2
          ComSignalType = UINT8
          ComTransferProperty = TRIGGERED_ON_CHANGE
          ComFilter: ComFilterAlgorithm=MASKED_NEW_EQUALS_X, ComFilterMask=28, ComFilterX=28
        SIGNAL_I (ComGroupSignal):
          ComBitPosition = 16
          ComBitSize = 8
          ComHandleId = 8
          ComSignalDataInvalidValue = 33
          ComSignalEndianness = LITTLE_ENDIAN
          ComSignalInitValue = 3
          ComSignalType = UINT8
          ComTransferProperty = TRIGGERED_ON_CHANGE
          ComFilter: ComFilterAlgorithm=MASKED_NEW_EQUALS_X, ComFilterMask=28, ComFilterX=28
      ComIPdu_3 (ComIPdu):
        ComIPduDirection = RECEIVE
        ComIPduSignalProcessing = IMMEDIATE
        ComIPduHandleId = 3
        ComIPduType = NORMAL
        ComIPduGroupRef = ComIPduGroup_0
        ComIPduSignalRef = SIGNAL_J
        ComIPduSignalGroupRef = SIGNAL_G_D
        ComPduIdRef = Pdu_D
      SIGNAL_J (ComSignal):
        ComBitPosition = 0
        ComBitSize = 8
        ComHandleId = 9
        ComFirstTimeout = 2.0
        ComTimeout = 4.0
        ComNotification = Rte_COMCbkRxAck_snJ
        ComInvalidNotification = Rte_COMCbkInv_snJ
        ComTimeoutNotification = Rte_COMCbkRxTOut_snJ
        ComSignalDataInvalidValue = 44
        ComSignalEndianness = LITTLE_ENDIAN
        ComSignalInitValue = 4
        ComSignalType = UINT8
        ComTransferProperty = TRIGGERED
      SIGNAL_G_D (ComSignalGroup):
        ComHandleId = 3
        ComTransferProperty = TRIGGERED_ON_CHANGE
        ComFirstTimeout = 2.0
        ComTimeout = 4.0
        ComNotification = Rte_COMCbkRxAck_sgD
        ComInvalidNotification = Rte_COMCbkInv_sgD
        ComTimeoutNotification = Rte_COMCbkRxTOut_sgD
        SIGNAL_K (ComGroupSignal):
          ComBitPosition = 8
          ComBitSize = 8
          ComHandleId = 10
          ComSignalDataInvalidValue = 55
          ComSignalEndianness = LITTLE_ENDIAN
          ComSignalInitValue = 5
          ComSignalType = UINT8
          ComTransferProperty = TRIGGERED_ON_CHANGE
        SIGNAL_L (ComGroupSignal):
          ComBitPosition = 16
          ComBitSize = 8
          ComHandleId = 11
          ComSignalDataInvalidValue = 66
          ComSignalEndianness = LITTLE_ENDIAN
          ComSignalInitValue = 6
          ComSignalType = UINT8
          ComTransferProperty = TRIGGERED_ON_CHANGE
      ComIPdu_4 (ComIPdu):
        ComIPduDirection = SEND
        ComIPduSignalProcessing = IMMEDIATE
        ComIPduHandleId = 4
        ComIPduType = NORMAL
        ComIPduCancellationSupport = true
        ComIPduGroupRef = ComIPduGroup_0
        ComIPduSignalRef = SIGNAL_M
        ComIPduSignalGroupRef = SIGNAL_G_E
        ComPduIdRef = Pdu_E
        ComTxIPdu: ComTxIPduUnusedAreasDefault=1
          ComTxModeFalse
            ComTxMode: ComTxModeMode=DIRECT, ComTxModeNumberOfRepetitions=2, ComTxModeRepetitionPeriod=3.0
          ComTxModeTrue
            ComTxMode: ComTxModeMode=PERIODIC, ComTxModeTimeOffset=3.0, ComTxModeTimePeriod=5.0
      SIGNAL_M (ComSignal):
        ComBitPosition = 0
        ComBitSize = 8
        ComHandleId = 12
        ComFirstTimeout = 2.0
        ComTimeout = 4.0
        ComNotification = Rte_COMCbkTxAck_snM
        ComErrorNotification = Rte_COMCbkTxErr_snM
        ComTimeoutNotification = Rte_COMCbkTxTOut_snM
        ComSignalDataInvalidValue = 11
        ComSignalEndianness = LITTLE_ENDIAN
        ComSignalInitValue = 1
        ComSignalType = UINT8
        ComTransferProperty = TRIGGERED_ON_CHANGE
        ComFilter: ComFilterAlgorithm=MASKED_NEW_DIFFERS_MASKED_OLD, ComFilterMask=1
      SIGNAL_G_E (ComSignalGroup):
        ComHandleId = 4
        ComTransferProperty = TRIGGERED_ON_CHANGE
        ComFirstTimeout = 2.0
        ComTimeout = 4.0
        ComNotification = Rte_COMCbkTxAck_sgE
        ComErrorNotification = Rte_COMCbkTxErr_sgE
        ComTimeoutNotification = Rte_COMCbkTxTOut_sgE
        SIGNAL_N (ComGroupSignal):
          ComBitPosition = 8
          ComBitSize = 8
          ComHandleId = 13
          ComSignalDataInvalidValue = 22
          ComSignalEndianness = LITTLE_ENDIAN
          ComSignalInitValue = 2
          ComSignalType = UINT8
          ComTransferProperty = TRIGGERED_ON_CHANGE
          ComFilter: ComFilterAlgorithm=MASKED_NEW_EQUALS_X, ComFilterMask=28, ComFilterX=28
        SIGNAL_O (ComGroupSignal):
          ComBitPosition = 16
          ComBitSize = 8
          ComHandleId = 14
          ComSignalDataInvalidValue = 33
          ComSignalEndianness = LITTLE_ENDIAN
          ComSignalInitValue = 3
          ComSignalType = UINT8
          ComTransferProperty = TRIGGERED_ON_CHANGE
          ComFilter: ComFilterAlgorithm=MASKED_NEW_EQUALS_X, ComFilterMask=28, ComFilterX=28
      ComIPdu_5 (ComIPdu):
        ComIPduDirection = RECEIVE
        ComIPduSignalProcessing = IMMEDIATE
        ComIPduHandleId = 5
        ComIPduType = NORMAL
        ComIPduGroupRef = ComIPduGroup_0
        ComIPduSignalRef = SIGNAL_P
        ComIPduSignalGroupRef = SIGNAL_G_F
        ComPduIdRef = Pdu_F
      SIGNAL_P (ComSignal):
        ComBitPosition = 0
        ComBitSize = 8
        ComHandleId = 15
        ComFirstTimeout = 2.0
        ComTimeout = 4.0
        ComNotification = Rte_COMCbkRxAck_snP
        ComInvalidNotification = Rte_COMCbkInv_snP
        ComTimeoutNotification = Rte_COMCbkRxTOut_snP
        ComSignalDataInvalidValue = 44
        ComSignalEndianness = LITTLE_ENDIAN
        ComSignalInitValue = 4
        ComSignalType = UINT8
        ComTransferProperty = TRIGGERED
      SIGNAL_G_F (ComSignalGroup):
        ComHandleId = 5
        ComTransferProperty = TRIGGERED_ON_CHANGE
        ComFirstTimeout = 2.0
        ComTimeout = 4.0
        ComNotification = Rte_COMCbkRxAck_sgF
        ComInvalidNotification = Rte_COMCbkInv_sgF
        ComTimeoutNotification = Rte_COMCbkRxTOut_sgF
        SIGNAL_Q (ComGroupSignal):
          ComBitPosition = 8
          ComBitSize = 8
          ComHandleId = 16
          ComSignalDataInvalidValue = 55
          ComSignalEndianness = LITTLE_ENDIAN
          ComSignalInitValue = 5
          ComSignalType = UINT8
          ComTransferProperty = TRIGGERED_ON_CHANGE
        SIGNAL_R (ComGroupSignal):
          ComBitPosition = 16
          ComBitSize = 8
          ComHandleId = 17
          ComSignalDataInvalidValue = 66
          ComSignalEndianness = LITTLE_ENDIAN
          ComSignalInitValue = 6
          ComSignalType = UINT8
          ComTransferProperty = TRIGGERED_ON_CHANGE
package /CanTp
  module config CanTp: ecuc-def-edition=4.2.0, implementation-config-variant=VARIANT-PRE-COMPILE
    CanTpGeneral:
      CanTpDevErrorDetect = true
      CanTpDynIdSupport = false
      CanTpFlexibleDataRateSupport = true
      CanTpGenericConnectionSupport = false
      CanTpChangeParameterApi = true
      CanTpReadParameterApi = true
      CanTpVersionInfoApi = true
      CanTpPaddingByte = 255
    CanTpConfig_0 (CanTpConfig): CanTpMainFunctionPeriod=0.005, CanTpMaxChannelCnt=2
      CanTpChannel_0 (CanTpChannel): CanTpChannelMode=CANTP_MODE_FULL_DUPLEX
        CanTpTxNSdu_A (CanTpTxNSdu):
          CanTpNas = 1.0
          CanTpNbs = 5.0
          CanTpNcs = 5.0
          CanTpTc = true
          CanTpTxAddressingFormat = CANTP_STANDARD
          CanTpTxPaddingActivation = CANTP_ON
          CanTpTxTaType = CANTP_PHYSICAL
          CanTpTxNSduId = 0
          CanTpTxNSduRef = Sdu_A
          CanTpTxNPdu: CanTpTxNPduConfirmationPduId=0, CanTpTxNPduRef=Pdu_0
          CanTpRxFcNPdu: CanTpRxFcNPduId=1, CanTpRxFcNPduRef=Pdu_1
        CanTpRxNSdu_B (CanTpRxNSdu):
          CanTpBs = 0
          CanTpNar = 1.0
          CanTpNbr = 5.0
          CanTpNcr = 5.0
          CanTpTc = true
          CanTpRxAddressingFormat = CANTP_STANDARD
          CanTpRxPaddingActivation = CANTP_ON
          CanTpRxTaType = CANTP_PHYSICAL
          CanTpRxWftMax = 5
          CanTpSTmin = 0.0
          CanTpRxNSduId = 1
          CanTpRxNSduRef = Sdu_B
          CanTpTxFcNPdu: CanTpTxFcNPduConfirmationPduId=2, CanTpTxFcNPduRef=Pdu_2
          CanTpRxNPdu: CanTpRxNPduId=3, CanTpRxNPduRef=Pdu_3
        CanTpTxNSdu_C (CanTpTxNSdu):
          CanTpNas = 1.0
          CanTpNbs = 5.0
          CanTpNcs = 5.0
          CanTpTc = true
          CanTpTxAddressingFormat = CANTP_STANDARD
          CanTpTxPaddingActivation = CANTP_ON
          CanTpTxTaType = CANTP_CANFD_PHYSICAL
          CanTpTxNSduId = 2
          CanTpTxNSduRef = Sdu_C
          CanTpTxNPdu: CanTpTxNPduConfirmationPduId=4, CanTpTxNPduRef=Pdu_4
          CanTpRxFcNPdu: CanTpRxFcNPduId=5, CanTpRxFcNPduRef=Pdu_5
        CanTpRxNSdu_D (CanTpRxNSdu):
          CanTpBs = 0
          CanTpNar = 1.0
          CanTpNbr = 5.0
          CanTpNcr = 5.0
          CanTpTc = true
          CanTpRxAddressingFormat = CANTP_STANDARD
          CanTpRxPaddingActivation = CANTP_ON
          CanTpRxTaType = CANTP_CANFD_PHYSICAL
          CanTpRxWftMax = 5
          CanTpSTmin = 0.0
          CanTpRxNSduId = 3
          CanTpRxNSduRef = Sdu_D
          CanTpTxFcNPdu: CanTpTxFcNPduConfirmationPduId=6, CanTpTxFcNPduRef=Pdu_6
          CanTpRxNPdu: CanTpRxNPduId=7, CanTpRxNPduRef=Pdu_7
        CanTpTxNSdu_E (CanTpTxNSdu):
          CanTpNas = 1.0
          CanTpNbs = 5.0
          CanTpNcs = 5.0
          CanTpTc = true
          CanTpTxAddressingFormat = CANTP_EXTENDED
          CanTpTxPaddingActivation = CANTP_ON
          CanTpTxTaType = CANTP_PHYSICAL
          CanTpTxNSduId = 4
          CanTpTxNSduRef = Sdu_E
          CanTpTxNPdu: CanTpTxNPduConfirmationPduId=8, CanTpTxNPduRef=Pdu_8
          CanTpRxFcNPdu: CanTpRxFcNPduId=9, CanTpRxFcNPduRef=Pdu_9
          CanTpNTa: CanTpNTa=85
        CanTpRxNSdu_F (CanTpRxNSdu):
          CanTpBs = 0
          CanTpNar = 1.0
          CanTpNbr = 5.0
          CanTpNcr = 5.0
          CanTpTc = true
          CanTpRxAddressingFormat = CANTP_EXTENDED
          CanTpRxPaddingActivation = CANTP_ON
          CanTpRxTaType = CANTP_PHYSICAL
          CanTpRxWftMax = 5
          CanTpSTmin = 0.0
          CanTpRxNSduId = 5
          CanTpRxNSduRef = Sdu_F
          CanTpTxFcNPdu: CanTpTxFcNPduConfirmationPduId=10, CanTpTxFcNPduRef=Pdu_10
          CanTpRxNPdu: CanTpRxNPduId=11, CanTpRxNPduRef=Pdu_11
          CanTpNTa: CanTpNTa=170
      CanTpChannel_1 (CanTpChannel): CanTpChannelMode=CANTP_MODE_FULL_DUPLEX
        CanTpTxNSdu_G (CanTpTxNSdu):
          CanTpNas = 1.0
          CanTpNbs = 5.0
          CanTpNcs = 5.0
          CanTpTc = true
          CanTpTxAddressingFormat = CANTP_EXTENDED
          CanTpTxPaddingActivation = CANTP_ON
          CanTpTxTaType = CANTP_PHYSICAL
          CanTpTxNSduId = 6
          CanTpTxNSduRef = Sdu_G
          CanTpTxNPdu: CanTpTxNPduConfirmationPduId=12, CanTpTxNPduRef=Pdu_12
          CanTpRxFcNPdu: CanTpRxFcNPduId=13, CanTpRxFcNPduRef=Pdu_13
          CanTpNTa: CanTpNTa=86
        CanTpRxNSdu_H (CanTpRxNSdu):
          CanTpBs = 0
          CanTpNar = 1.0
          CanTpNbr = 5.0
          CanTpNcr = 5.0
          CanTpTc = true
          CanTpRxAddressingFormat = CANTP_EXTENDED
          CanTpRxPaddingActivation = CANTP_ON
          CanTpRxTaType = CANTP_PHYSICAL
          CanTpRxWftMax = 5
          CanTpSTmin = 0.0
          CanTpRxNSduId = 7
          CanTpRxNSduRef = Sdu_H
          CanTpTxFcNPdu: CanTpTxFcNPduConfirmationPduId=14, CanTpTxFcNPduRef=Pdu_14
          CanTpRxNPdu: CanTpRxNPduId=15, CanTpRxNPduRef=Pdu_15
          CanTpNTa: CanTpNTa=171
package /CanIf
  module config CanIf: ecuc-def-edition=4.2.0, implementation-config-variant=VARIANT-PRE-COMPILE
    CanIfPublicCfg:
      CanIfPublicCancelTransmitSupport = true
      CanIfPublicChangeBaudrateSupport = true
      CanIfPublicDevErrorDetect = true
      CanIfPublicHandleTypeEnum = UINT8
      CanIfPublicMultipleDrvSupport = false
      CanIfPublicNumberOfCanHwUnits = 1
      CanIfPublicPnSupport = false
      CanIfPublicReadRxPduDataApi = true
      CanIfPublicReadRxPduNotifyStatusApi = true
      CanIfPublicReadTxPduNotifyStatusApi = true
      CanIfPublicSetDynamicTxIdApi = false
      CanIfPublicTxBuffering = false
      CanIfPublicTxConfirmPollingSupport = true
      CanIfPublicVersionInfoApi = true
      CanIfPublicWakeupCheckValidSupport = true
    CanIfPrivateCfg: CanIfPrivateDlcCheck=false, CanIfSupportTTCAN=false
    CanIfDispatchCfg:
      CanIfDispatchUserCtrlBusOffName = CanSM_ControllerBusOff
      CanIfDispatchUserCtrlBusOffUL = CAN_SM
      CanIfDispatchUserCtrlModeIndicationName = CanSM_ControllerModeIndication
      CanIfDispatchUserCtrlModeIndicationUL = CAN_SM
      CanIfDispatchUserValidateWakeupEventName = EcuM_ValidateWakeupEvent
      CanIfDispatchUserValidateWakeupEventUL = ECUM
    CanIfInitCfg_0 (CanIfInitCfg): CanIfInitCfgSet=main_canif_config
      12 x CanIfBufferCfg, all with CanIfBufferSize=0:
        CanIfBufferCfg_{0..11}: CanIfBufferHthRef=CanIfHthCfg_{0..11}
      CanIfInitHohCfg_0 (CanIfInitHohCfg): CanIfInitRefCfgSet=CanConfigSet
        12 x CanIfHrhCfg, all with CanIfHrhSoftwareFilter=false, CanIfHrhCanCtrlIdRef=CanIfCtrlCfg_0:
          CanIfHrhCfg_0: CanIfHrhIdSymRef=CanHardwareObject_1
          CanIfHrhCfg_1: CanIfHrhIdSymRef=CanHardwareObject_3
          CanIfHrhCfg_2: CanIfHrhIdSymRef=CanHardwareObject_5
          CanIfHrhCfg_3: CanIfHrhIdSymRef=CanHardwareObject_7
          CanIfHrhCfg_4: CanIfHrhIdSymRef=CanHardwareObject_9
          CanIfHrhCfg_5: CanIfHrhIdSymRef=CanHardwareObject_11
          CanIfHrhCfg_6: CanIfHrhIdSymRef=CanHardwareObject_13
          CanIfHrhCfg_7: CanIfHrhIdSymRef=CanHardwareObject_15
          CanIfHrhCfg_8: CanIfHrhIdSymRef=CanHardwareObject_17
          CanIfHrhCfg_9: CanIfHrhIdSymRef=CanHardwareObject_19
          CanIfHrhCfg_10: CanIfHrhIdSymRef=CanHardwareObject_21
          CanIfHrhCfg_11: CanIfHrhIdSymRef=CanHardwareObject_23
        12 x CanIfHthCfg, all with CanIfHthCanCtrlIdRef=CanIfCtrlCfg_0:
          CanIfHthCfg_0: CanIfHthIdSymRef=CanHardwareObject_0
          CanIfHthCfg_1: CanIfHthIdSymRef=CanHardwareObject_2
          CanIfHthCfg_2: CanIfHthIdSymRef=CanHardwareObject_4
          CanIfHthCfg_3: CanIfHthIdSymRef=CanHardwareObject_6
          CanIfHthCfg_4: CanIfHthIdSymRef=CanHardwareObject_8
          CanIfHthCfg_5: CanIfHthIdSymRef=CanHardwareObject_10
          CanIfHthCfg_6: CanIfHthIdSymRef=CanHardwareObject_12
          CanIfHthCfg_7: CanIfHthIdSymRef=CanHardwareObject_14
          CanIfHthCfg_8: CanIfHthIdSymRef=CanHardwareObject_16
          CanIfHthCfg_9: CanIfHthIdSymRef=CanHardwareObject_18
          CanIfHthCfg_10: CanIfHthIdSymRef=CanHardwareObject_20
          CanIfHthCfg_11: CanIfHthIdSymRef=CanHardwareObject_22
      12 x CanIfRxPduCfg:
        CanIfRxPduCfg_0: CanIfRxPduCanId=2, CanIfRxPduCanIdType=STANDARD_CAN, CanIfRxPduDlc=8, CanIfRxPduId=1, CanIfRxPduReadData=false, CanIfRxPduReadNotifyStatus=false, CanIfRxPduUserRxIndicationName=PduR_CanIfRxIndication, CanIfRxPduUserRxIndicationUL=PDUR, CanIfRxPduHrhIdRef=CanIfHrhCfg_0, CanIfRxPduRef=Pdu_B
        CanIfRxPduCfg_1: CanIfRxPduCanId=4, CanIfRxPduCanIdType=STANDARD_CAN, CanIfRxPduDlc=8, CanIfRxPduId=3, CanIfRxPduReadData=true, CanIfRxPduReadNotifyStatus=true, CanIfRxPduUserRxIndicationName=PduR_CanIfRxIndication, CanIfRxPduUserRxIndicationUL=PDUR, CanIfRxPduHrhIdRef=CanIfHrhCfg_1, CanIfRxPduRef=Pdu_D
        CanIfRxPduCfg_2: CanIfRxPduCanId=6, CanIfRxPduCanIdType=STANDARD_FD_CAN, CanIfRxPduDlc=20, CanIfRxPduId=5, CanIfRxPduReadData=true, CanIfRxPduReadNotifyStatus=false, CanIfRxPduUserRxIndicationName=PduR_CanIfRxIndication, CanIfRxPduUserRxIndicationUL=PDUR, CanIfRxPduHrhIdRef=CanIfHrhCfg_2, CanIfRxPduRef=Pdu_F
        CanIfRxPduCfg_3: CanIfRxPduCanId=8, CanIfRxPduCanIdType=STANDARD_FD_CAN, CanIfRxPduDlc=32, CanIfRxPduId=7, CanIfRxPduReadData=true, CanIfRxPduReadNotifyStatus=false, CanIfRxPduUserRxIndicationName=PduR_CanIfRxIndication, CanIfRxPduUserRxIndicationUL=PDUR, CanIfRxPduHrhIdRef=CanIfHrhCfg_3, CanIfRxPduRef=Pdu_H
        CanIfRxPduCfg_4: CanIfRxPduCanId=10, CanIfRxPduCanIdType=STANDARD_CAN, CanIfRxPduDlc=8, CanIfRxPduId=9, CanIfRxPduReadData=false, CanIfRxPduReadNotifyStatus=false, CanIfRxPduUserRxIndicationName=CanTp_RxIndication, CanIfRxPduUserRxIndicationUL=CAN_TP, CanIfRxPduHrhIdRef=CanIfHrhCfg_4, CanIfRxPduRef=Pdu_1
        CanIfRxPduCfg_5: CanIfRxPduCanId=12, CanIfRxPduCanIdType=STANDARD_CAN, CanIfRxPduDlc=8, CanIfRxPduId=11, CanIfRxPduReadData=true, CanIfRxPduReadNotifyStatus=true, CanIfRxPduUserRxIndicationName=CanTp_RxIndication, CanIfRxPduUserRxIndicationUL=CAN_TP, CanIfRxPduHrhIdRef=CanIfHrhCfg_5, CanIfRxPduRef=Pdu_3
        CanIfRxPduCfg_6: CanIfRxPduCanId=14, CanIfRxPduCanIdType=STANDARD_FD_CAN, CanIfRxPduDlc=64, CanIfRxPduId=13, CanIfRxPduReadData=true, CanIfRxPduReadNotifyStatus=false, CanIfRxPduUserRxIndicationName=CanTp_RxIndication, CanIfRxPduUserRxIndicationUL=CAN_TP, CanIfRxPduHrhIdRef=CanIfHrhCfg_6, CanIfRxPduRef=Pdu_5
        CanIfRxPduCfg_7: CanIfRxPduCanId=16, CanIfRxPduCanIdType=STANDARD_FD_CAN, CanIfRxPduDlc=64, CanIfRxPduId=15, CanIfRxPduReadData=true, CanIfRxPduReadNotifyStatus=false, CanIfRxPduUserRxIndicationName=CanTp_RxIndication, CanIfRxPduUserRxIndicationUL=CAN_TP, CanIfRxPduHrhIdRef=CanIfHrhCfg_7, CanIfRxPduRef=Pdu_7
        CanIfRxPduCfg_8: CanIfRxPduCanId=18, CanIfRxPduCanIdType=STANDARD_CAN, CanIfRxPduDlc=8, CanIfRxPduId=17, CanIfRxPduReadData=false, CanIfRxPduReadNotifyStatus=false, CanIfRxPduUserRxIndicationName=CanTp_RxIndication, CanIfRxPduUserRxIndicationUL=CAN_TP, CanIfRxPduHrhIdRef=CanIfHrhCfg_8, CanIfRxPduRef=Pdu_9
        CanIfRxPduCfg_9: CanIfRxPduCanId=20, CanIfRxPduCanIdType=STANDARD_CAN, CanIfRxPduDlc=8, CanIfRxPduId=19, CanIfRxPduReadData=true, CanIfRxPduReadNotifyStatus=true, CanIfRxPduUserRxIndicationName=CanTp_RxIndication, CanIfRxPduUserRxIndicationUL=CAN_TP, CanIfRxPduHrhIdRef=CanIfHrhCfg_9, CanIfRxPduRef=Pdu_11
        CanIfRxPduCfg_10: CanIfRxPduCanId=18, CanIfRxPduCanIdType=STANDARD_CAN, CanIfRxPduDlc=8, CanIfRxPduId=21, CanIfRxPduReadData=false, CanIfRxPduReadNotifyStatus=false, CanIfRxPduUserRxIndicationName=CanTp_RxIndication, CanIfRxPduUserRxIndicationUL=CAN_TP, CanIfRxPduHrhIdRef=CanIfHrhCfg_10, CanIfRxPduRef=Pdu_13
        CanIfRxPduCfg_11: CanIfRxPduCanId=20, CanIfRxPduCanIdType=STANDARD_CAN, CanIfRxPduDlc=8, CanIfRxPduId=23, CanIfRxPduReadData=true, CanIfRxPduReadNotifyStatus=true, CanIfRxPduUserRxIndicationName=CanTp_RxIndication, CanIfRxPduUserRxIndicationUL=CAN_TP, CanIfRxPduHrhIdRef=CanIfHrhCfg_11, CanIfRxPduRef=Pdu_15
      12 x CanIfTxPduCfg, all with CanIfTxPduPnFilterPdu=false, CanIfTxPduType=STATIC:
        CanIfTxPduCfg_0: CanIfTxPduCanId=1, CanIfTxPduCanIdType=STANDARD_CAN, CanIfTxPduDlc=8, CanIfTxPduId=0, CanIfTxPduReadNotifyStatus=true, CanIfTxPduUserTxConfirmationName=PduR_CanIfTxConfirmation, CanIfTxPduUserTxConfirmationUL=PDUR, CanIfTxPduBufferRef=CanIfBufferCfg_0, CanIfTxPduRef=Pdu_A
        CanIfTxPduCfg_1: CanIfTxPduCanId=3, CanIfTxPduCanIdType=STANDARD_CAN, CanIfTxPduDlc=8, CanIfTxPduId=2, CanIfTxPduReadNotifyStatus=true, CanIfTxPduUserTxConfirmationName=PduR_CanIfTxConfirmation, CanIfTxPduUserTxConfirmationUL=PDUR, CanIfTxPduBufferRef=CanIfBufferCfg_1, CanIfTxPduRef=Pdu_C
        CanIfTxPduCfg_2: CanIfTxPduCanId=5, CanIfTxPduCanIdType=STANDARD_FD_CAN, CanIfTxPduDlc=12, CanIfTxPduId=4, CanIfTxPduReadNotifyStatus=false, CanIfTxPduUserTxConfirmationName=PduR_CanIfTxConfirmation, CanIfTxPduUserTxConfirmationUL=PDUR, CanIfTxPduBufferRef=CanIfBufferCfg_2, CanIfTxPduRef=Pdu_E
        CanIfTxPduCfg_3: CanIfTxPduCanId=7, CanIfTxPduCanIdType=STANDARD_FD_CAN, CanIfTxPduDlc=64, CanIfTxPduId=6, CanIfTxPduReadNotifyStatus=false, CanIfTxPduUserTxConfirmationName=PduR_CanIfTxConfirmation, CanIfTxPduUserTxConfirmationUL=PDUR, CanIfTxPduBufferRef=CanIfBufferCfg_3, CanIfTxPduRef=Pdu_G
        CanIfTxPduCfg_4: CanIfTxPduCanId=9, CanIfTxPduCanIdType=STANDARD_CAN, CanIfTxPduDlc=8, CanIfTxPduId=8, CanIfTxPduReadNotifyStatus=true, CanIfTxPduUserTxConfirmationName=CanTp_TxConfirmation, CanIfTxPduUserTxConfirmationUL=CAN_TP, CanIfTxPduBufferRef=CanIfBufferCfg_4, CanIfTxPduRef=Pdu_0
        CanIfTxPduCfg_5: CanIfTxPduCanId=11, CanIfTxPduCanIdType=STANDARD_CAN, CanIfTxPduDlc=8, CanIfTxPduId=10, CanIfTxPduReadNotifyStatus=true, CanIfTxPduUserTxConfirmationName=CanTp_TxConfirmation, CanIfTxPduUserTxConfirmationUL=CAN_TP, CanIfTxPduBufferRef=CanIfBufferCfg_5, CanIfTxPduRef=Pdu_2
        CanIfTxPduCfg_6: CanIfTxPduCanId=13, CanIfTxPduCanIdType=STANDARD_FD_CAN, CanIfTxPduDlc=64, CanIfTxPduId=12, CanIfTxPduReadNotifyStatus=false, CanIfTxPduUserTxConfirmationName=CanTp_TxConfirmation, CanIfTxPduUserTxConfirmationUL=CAN_TP, CanIfTxPduBufferRef=CanIfBufferCfg_6, CanIfTxPduRef=Pdu_4
        CanIfTxPduCfg_7: CanIfTxPduCanId=15, CanIfTxPduCanIdType=STANDARD_FD_CAN, CanIfTxPduDlc=64, CanIfTxPduId=14, CanIfTxPduReadNotifyStatus=false, CanIfTxPduUserTxConfirmationName=CanTp_TxConfirmation, CanIfTxPduUserTxConfirmationUL=CAN_TP, CanIfTxPduBufferRef=CanIfBufferCfg_7, CanIfTxPduRef=Pdu_6
        CanIfTxPduCfg_8: CanIfTxPduCanId=17, CanIfTxPduCanIdType=STANDARD_CAN, CanIfTxPduDlc=8, CanIfTxPduId=16, CanIfTxPduReadNotifyStatus=true, CanIfTxPduUserTxConfirmationName=CanTp_TxConfirmation, CanIfTxPduUserTxConfirmationUL=CAN_TP, CanIfTxPduBufferRef=CanIfBufferCfg_8, CanIfTxPduRef=Pdu_8
        CanIfTxPduCfg_9: CanIfTxPduCanId=19, CanIfTxPduCanIdType=STANDARD_CAN, CanIfTxPduDlc=8, CanIfTxPduId=18, CanIfTxPduReadNotifyStatus=true, CanIfTxPduUserTxConfirmationName=CanTp_TxConfirmation, CanIfTxPduUserTxConfirmationUL=CAN_TP, CanIfTxPduBufferRef=CanIfBufferCfg_9, CanIfTxPduRef=Pdu_10
        CanIfTxPduCfg_10: CanIfTxPduCanId=17, CanIfTxPduCanIdType=STANDARD_CAN, CanIfTxPduDlc=8, CanIfTxPduId=20, CanIfTxPduReadNotifyStatus=true, CanIfTxPduUserTxConfirmationName=CanTp_TxConfirmation, CanIfTxPduUserTxConfirmationUL=CAN_TP, CanIfTxPduBufferRef=CanIfBufferCfg_10, CanIfTxPduRef=Pdu_12
        CanIfTxPduCfg_11: CanIfTxPduCanId=19, CanIfTxPduCanIdType=STANDARD_CAN, CanIfTxPduDlc=8, CanIfTxPduId=22, CanIfTxPduReadNotifyStatus=true, CanIfTxPduUserTxConfirmationName=CanTp_TxConfirmation, CanIfTxPduUserTxConfirmationUL=CAN_TP, CanIfTxPduBufferRef=CanIfBufferCfg_11, CanIfTxPduRef=Pdu_14
    CanIfCtrlDrvCfg_0 (CanIfCtrlDrvCfg): CanIfCtrlDrvTxCancellation=false, CanIfCtrlDrvInitHohConfigRef=CanIfInitHohCfg_0, CanIfCtrlDrvNameRef=CanGeneral
      CanIfCtrlCfg_0 (CanIfCtrlCfg): CanIfCtrlId=0, CanIfCtrlWakeupSupport=true, CanIfCtrlCanCtrlRef=CanController_0
package /EcuC
  module config EcuC: ecuc-def-edition=4.2.0, implementation-config-variant=VARIANT-PRE-COMPILE
    EcucPduCollection: PduIdTypeEnum=UINT16, PduLengthTypeEnum=UINT16
      32 x Pdu:
        Pdu_A: PduLength=3
        Pdu_B: PduLength=7
        Pdu_C: PduLength=4
        Pdu_D: PduLength=5
        Pdu_E: PduLength=12
        Pdu_F: PduLength=20
        Pdu_G: PduLength=64
        Pdu_H: PduLength=32
        Sdu_A: PduLength=5
        Pdu_0: PduLength=8
        Pdu_1: PduLength=8
        Sdu_B: PduLength=5
        Pdu_2: PduLength=8
        Pdu_3: PduLength=8
        Sdu_C: PduLength=100
        Pdu_4: PduLength=64
        Pdu_5: PduLength=8
        Sdu_D: PduLength=100
        Pdu_6: PduLength=8
        Pdu_7: PduLength=64
        Sdu_E: PduLength=10
        Pdu_8: PduLength=8
        Pdu_9: PduLength=8
        Sdu_F: PduLength=10
        Pdu_10: PduLength=8
        Pdu_11: PduLength=8
        Sdu_G: PduLength=10
        Pdu_12: PduLength=8
        Pdu_13: PduLength=8
        Sdu_H: PduLength=10
        Pdu_14: PduLength=8
        Pdu_15: PduLength=8
package /PduR
  module config PduR: ecuc-def-edition=4.2.0, implementation-config-variant=VARIANT-PRE-COMPILE
    PduRGeneral: PduRDevErrorDetect=false, PduRVersionInfoApi=false, PduRZeroCostOperation=true
    PduRRoutingTables: PduRConfigurationId=0
      PduRRoutingTable: PduRIsMinimumRouting=false
        16 x PduRRoutingPath:
          PduRRoutingPath_0
            PduRDestPdu_0 (PduRDestPdu): PduRDestPduHandleId=0, PduRDestPduRef=Pdu_A
            PduRSrcPdu_0 (PduRSrcPdu): PduRSourcePduHandleId=0, PduRSrcPduRef=Pdu_A
          PduRRoutingPath_1
            PduRDestPdu_1 (PduRDestPdu): PduRDestPduRef=Pdu_B
            PduRSrcPdu_1 (PduRSrcPdu): PduRSourcePduHandleId=1, PduRSrcPduRef=Pdu_B
          PduRRoutingPath_2
            PduRDestPdu_2 (PduRDestPdu): PduRDestPduHandleId=2, PduRDestPduRef=Pdu_C
            PduRSrcPdu_2 (PduRSrcPdu): PduRSourcePduHandleId=2, PduRSrcPduRef=Pdu_C
          PduRRoutingPath_3
            PduRDestPdu_3 (PduRDestPdu): PduRDestPduRef=Pdu_D
            PduRSrcPdu_3 (PduRSrcPdu): PduRSourcePduHandleId=3, PduRSrcPduRef=Pdu_D
          PduRRoutingPath_4
            PduRDestPdu_4 (PduRDestPdu): PduRDestPduHandleId=4, PduRDestPduRef=Pdu_E
            PduRSrcPdu_4 (PduRSrcPdu): PduRSourcePduHandleId=4, PduRSrcPduRef=Pdu_E
          PduRRoutingPath_5
            PduRDestPdu_5 (PduRDestPdu): PduRDestPduRef=Pdu_F
            PduRSrcPdu_5 (PduRSrcPdu): PduRSourcePduHandleId=5, PduRSrcPduRef=Pdu_F
          PduRRoutingPath_6
            PduRDestPdu_6 (PduRDestPdu): PduRDestPduHandleId=6, PduRDestPduRef=Pdu_G
            PduRSrcPdu_6 (PduRSrcPdu): PduRSourcePduHandleId=6, PduRSrcPduRef=Pdu_G
          PduRRoutingPath_7
            PduRDestPdu_7 (PduRDestPdu): PduRDestPduRef=Pdu_H
            PduRSrcPdu_7 (PduRSrcPdu): PduRSourcePduHandleId=7, PduRSrcPduRef=Pdu_H
          PduRRoutingPath_8
            PduRDestPdu_8 (PduRDestPdu): PduRDestPduHandleId=8, PduRDestPduRef=Sdu_A
            PduRSrcPdu_8 (PduRSrcPdu): PduRSourcePduHandleId=8, PduRSrcPduRef=Sdu_A
          PduRRoutingPath_9
            PduRDestPdu_9 (PduRDestPdu): PduRDestPduRef=Sdu_B
            PduRSrcPdu_9 (PduRSrcPdu): PduRSourcePduHandleId=9, PduRSrcPduRef=Sdu_B
          PduRRoutingPath_10
            PduRDestPdu_10 (PduRDestPdu): PduRDestPduHandleId=10, PduRDestPduRef=Sdu_C
            PduRSrcPdu_10 (PduRSrcPdu): PduRSourcePduHandleId=10, PduRSrcPduRef=Sdu_C
          PduRRoutingPath_11
            PduRDestPdu_11 (PduRDestPdu): PduRDestPduRef=Sdu_D
            PduRSrcPdu_11 (PduRSrcPdu): PduRSourcePduHandleId=11, PduRSrcPduRef=Sdu_D
          PduRRoutingPath_12
            PduRDestPdu_12 (PduRDestPdu): PduRDestPduHandleId=12, PduRDestPduRef=Sdu_E
            PduRSrcPdu_12 (PduRSrcPdu): PduRSourcePduHandleId=12, PduRSrcPduRef=Sdu_E
          PduRRoutingPath_13
            PduRDestPdu_13 (PduRDestPdu): PduRDestPduRef=Sdu_F
            PduRSrcPdu_13 (PduRSrcPdu): PduRSourcePduHandleId=13, PduRSrcPduRef=Sdu_F
          PduRRoutingPath_14
            PduRDestPdu_14 (PduRDestPdu): PduRDestPduHandleId=14, PduRDestPduRef=Sdu_G
            PduRSrcPdu_14 (PduRSrcPdu): PduRSourcePduHandleId=14, PduRSrcPduRef=Sdu_G
          PduRRoutingPath_15
            PduRDestPdu_15 (PduRDestPdu): PduRDestPduRef=Sdu_H
            PduRSrcPdu_15 (PduRSrcPdu): PduRSourcePduHandleId=15, PduRSrcPduRef=Sdu_H
package /Can
  module config Can: ecuc-def-edition=4.2.0, implementation-config-variant=VARIANT-PRE-COMPILE
    CanConfigSet
      CanController_0 (CanController):
        CanBusoffProcessing = INTERRUPT
        CanControllerId = 0
        CanRxProcessing = INTERRUPT
        CanTxProcessing = INTERRUPT
        CanWakeupProcessing = INTERRUPT
        CanWakeupSupport = false
        CanControllerDefaultBaudrate = CanControllerBaudrateConfig_0
        CanWakeupSourceRef = EcuMWakeupSource_0
        CanControllerBaudrateConfig_0 (CanControllerBaudrateConfig): CanControllerBaudRate=500
        CanControllerBaudrateConfig_1 (CanControllerBaudrateConfig): CanControllerBaudRate=250
        12 x CanFilterMask:
          CanFilterMask_0: CanFilterMaskValue=18
          CanFilterMask_1: CanFilterMaskValue=20
          CanFilterMask_2: CanFilterMaskValue=22
          CanFilterMask_3: CanFilterMaskValue=24
          CanFilterMask_4: CanFilterMaskValue=26
          CanFilterMask_5: CanFilterMaskValue=28
          CanFilterMask_6: CanFilterMaskValue=30
          CanFilterMask_7: CanFilterMaskValue=32
          CanFilterMask_8: CanFilterMaskValue=34
          CanFilterMask_9: CanFilterMaskValue=36
          CanFilterMask_10: CanFilterMaskValue=38
          CanFilterMask_11: CanFilterMaskValue=40
      24 x CanHardwareObject, all with CanHandleType=FULL, CanIdType=STANDARD, CanControllerRef=CanController_0:
        CanHardwareObject_0: CanIdValue=1, CanObjectId=0, CanObjectType=TRANSMIT
        CanHardwareObject_1: CanIdValue=2, CanObjectId=1, CanObjectType=RECEIVE, CanFilterMaskRef=CanFilterMask_0
        CanHardwareObject_2: CanIdValue=3, CanObjectId=2, CanObjectType=TRANSMIT
        CanHardwareObject_3: CanIdValue=4, CanObjectId=3, CanObjectType=RECEIVE, CanFilterMaskRef=CanFilterMask_1
        CanHardwareObject_4: CanIdValue=5, CanObjectId=4, CanObjectType=TRANSMIT
        CanHardwareObject_5: CanIdValue=6, CanObjectId=5, CanObjectType=RECEIVE, CanFilterMaskRef=CanFilterMask_2
        CanHardwareObject_6: CanIdValue=7, CanObjectId=6, CanObjectType=TRANSMIT
        CanHardwareObject_7: CanIdValue=8, CanObjectId=7, CanObjectType=RECEIVE, CanFilterMaskRef=CanFilterMask_3
        CanHardwareObject_8: CanIdValue=9, CanObjectId=8, CanObjectType=TRANSMIT
        CanHardwareObject_9: CanIdValue=10, CanObjectId=9, CanObjectType=RECEIVE, CanFilterMaskRef=CanFilterMask_4
        CanHardwareObject_10: CanIdValue=11, CanObjectId=10, CanObjectType=TRANSMIT
        CanHardwareObject_11: CanIdValue=12, CanObjectId=11, CanObjectType=RECEIVE, CanFilterMaskRef=CanFilterMask_5
        CanHardwareObject_12: CanIdValue=13, CanObjectId=12, CanObjectType=TRANSMIT
        CanHardwareObject_13: CanIdValue=14, CanObjectId=13, CanObjectType=RECEIVE, CanFilterMaskRef=CanFilterMask_6
        CanHardwareObject_14: CanIdValue=15, CanObjectId=14, CanObjectType=TRANSMIT
        CanHardwareObject_15: CanIdValue=16, CanObjectId=15, CanObjectType=RECEIVE, CanFilterMaskRef=CanFilterMask_7
        CanHardwareObject_16: CanIdValue=17, CanObjectId=16, CanObjectType=TRANSMIT
        CanHardwareObject_17: CanIdValue=18, CanObjectId=17, CanObjectType=RECEIVE, CanFilterMaskRef=CanFilterMask_8
        CanHardwareObject_18: CanIdValue=19, CanObjectId=18, CanObjectType=TRANSMIT
        CanHardwareObject_19: CanIdValue=20, CanObjectId=19, CanObjectType=RECEIVE, CanFilterMaskRef=CanFilterMask_9
        CanHardwareObject_20: CanIdValue=17, CanObjectId=20, CanObjectType=TRANSMIT
        CanHardwareObject_21: CanIdValue=18, CanObjectId=21, CanObjectType=RECEIVE, CanFilterMaskRef=CanFilterMask_10
        CanHardwareObject_22: CanIdValue=19, CanObjectId=22, CanObjectType=TRANSMIT
        CanHardwareObject_23: CanIdValue=20, CanObjectId=23, CanObjectType=RECEIVE, CanFilterMaskRef=CanFilterMask_11
    CanGeneral: CanChangeBaudrateApi=false, CanDevErrorDetection=false, CanIndex=0, CanMultiplexedTransmission=false, CanVersionInfoApi=true
package /EcuM
  module config EcuM: ecuc-def-edition=4.2.0, implementation-config-variant=VARIANT-PRE-COMPILE
    EcuMConfiguration
      EcuMCommonConfiguration
        EcuMWakeupSource_0 (EcuMWakeupSource): EcuMWakeupSourceId=0
