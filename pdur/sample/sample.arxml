AUTOSAR XML (schema 4-0-3)
package /EcuC
  module config EcuC: ecuc-def-edition=4.2.0, implementation-config-variant=VARIANT-PRE-COMPILE
    EcucPduCollection: PduIdTypeEnum=UINT16, PduLengthTypeEnum=UINT16
      4 x Pdu:
        Pdu_0: PduLength=8
        Pdu_1: PduLength=6
        Pdu_2: PduLength=4
        Pdu_3: PduLength=2
package /Com
  module config Com: ecuc-def-edition=4.2.0, implementation-config-variant=VARIANT-PRE-COMPILE
    ComConfig
      4 x ComIPdu:
        ComIPdu_0: ComIPduHandleId=2, ComIPduDirection=RECEIVE, ComPduIdRef=Pdu_0
        ComIPdu_1: ComIPduHandleId=0, ComIPduDirection=SEND, ComPduIdRef=Pdu_1
        ComIPdu_2: ComIPduHandleId=3, ComIPduDirection=RECEIVE, ComPduIdRef=Pdu_2
        ComIPdu_3: ComIPduHandleId=1, ComIPduDirection=SEND, ComPduIdRef=Pdu_3
package /PduR
  module config PduR: ecuc-def-edition=4.2.0, implementation-config-variant=VARIANT-PRE-COMPILE
    PduRGeneral: PduRDevErrorDetect=false, PduRVersionInfoApi=false, PduRZeroCostOperation=true
    PduRRoutingTables: PduRConfigurationId=1
      PduRRoutingTable: PduRIsMinimumRouting=false
        4 x PduRRoutingPath:
          PduRRoutingPath_0
            PduRSrcPdu_0 (PduRSrcPdu): PduRSourcePduHandleId=2, PduRSrcPduRef=Pdu_0
            PduRDestPdu_0 (PduRDestPdu): PduRDestPduRef=Pdu_0
          PduRRoutingPath_1
            PduRSrcPdu_1 (PduRSrcPdu): PduRSourcePduHandleId=1, PduRSrcPduRef=Pdu_1
            PduRDestPdu_1 (PduRDestPdu): PduRDestPduHandleId=0, PduRDestPduRef=Pdu_1
          PduRRoutingPath_2
            PduRSrcPdu_2 (PduRSrcPdu): PduRSourcePduHandleId=3, PduRSrcPduRef=Pdu_2
            PduRDestPdu_2 (PduRDestPdu): PduRDestPduRef=Pdu_2
          PduRRoutingPath_3
            PduRSrcPdu_3 (PduRSrcPdu): PduRSourcePduHandleId=3, PduRSrcPduRef=Pdu_3
            PduRDestPdu_3 (PduRDestPdu): PduRDestPduHandleId=1, PduRDestPduRef=Pdu_3
package /CanIf
  module config CanIf: ecuc-def-edition=4.2.0, implementation-config-variant=VARIANT-PRE-COMPILE
    CanIfInitCfg
      CanIfRxPduCfg_0 (CanIfRxPduCfg): CanIfRxPduId=0, CanIfRxPduRef=Pdu_0
      CanIfTxPduCfg_1 (CanIfTxPduCfg): CanIfTxPduId=1, CanIfTxPduRef=Pdu_1
      CanIfRxPduCfg_2 (CanIfRxPduCfg): CanIfRxPduId=2, CanIfRxPduRef=Pdu_2
      CanIfTxPduCfg_3 (CanIfTxPduCfg): CanIfTxPduId=3, CanIfTxPduRef=Pdu_3
